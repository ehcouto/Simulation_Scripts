/**
 *  @file
 *
 *  @brief      Define the project specific API019 product information.
 *              Template - APII019 ProductInfo implementation.
 *
 *  @copyright  Copyright 2015-2017 Whirlpool Corporation. All rights reserved - CONFIDENTIAL
 */

//  --- Include Files -------------------------------------------------------------------------------------------------
#include "SystemConfig.h"
#include "ProductInfo.h" 
#include "Log.h"

#include <string.h>

//  --- Private Declarations ------------------------------------------------------------------------------------------
// Structure for board SW project information for each board.
typedef struct
{
    uint8                               Num_Of_Projects;        // define the number of projects in the board
    const API019_PROJECT_DATA_TYPE *    Project_Data;           // define the location of the board project data array
} API019_BOARD_PROJECT_TYPE;

//! Externally defined class B CRC
extern uint16 MICRO_FLASH_CRC;

//! Structure to temporarily hold API019 SW project data for publishing.
static API019_PROJECT_DATA_TYPE Temp_Data;

//  --- Private Definitions -------------------------------------------------------------------------------------------
//! Define the number of SW projects on the main board.
#define API019_BOARD_MAIN_NUM_PROJECTS     2

//! Define a constant to hold main board SW project types
static API019_PROJECT_TYPE API019_BOARD_MAIN_PROJECTS[API019_BOARD_MAIN_NUM_PROJECTS] = {API019_PROJECT_FIRMWARE,
                                                                                         API019_PROJECT_SETTINGFILE};

//! Define each set of project data for main board (Do NOT add data for the setting file).
static const API019_PROJECT_DATA_TYPE PRODUCTINFO_BOARD_MAIN_PROJECT_DATA[] =
{
    { // PRODUCTINFO_BOARD_ACU_PROJECT_FIRMWARE
    "VOSTOK ACU",                   /* char Project_Name[10];*/             \
    "MCUDEBUG01",                   /* char Project_Release_Number[10];*/   \
    "20231116",                     /* char Project_Release_Date[8];*/      \
    {0,7,200},                        /* uint8 Project_Release_Version[3];*/  \
	API019_MICRO_VENDOR_ST,         /* uint8 Micro_Vendor;*/                \
	API019_MICRO_ST_STM32G0X,       /* uint8 Micro_Specific;*/              \
    API019_PLATFORM_DISHWASHER,     /* uint8 Platform_Type;*/               \
    API019_DEVICE_ACU,              /* uint8 Device_Type;*/                 \
    1,                              /* uint8 Product_Cfg1;*/                \
    0,                              /* uint8 Product_Type;*/                \
    0,                              /* uint32 ClassB_CRC;*/                 \
    "           "                   /* char Project_ClassB_Id[8];*/         \
    }
};

// For each board listed in API019_BOARD_TYPE, define API019_BOARD_PROJECT_TYPE(s).
static const API019_BOARD_PROJECT_TYPE API019_BOARD_PROJECT_INFO[] =
{
    {   // PRODUCTINFO_BOARD_MAIN
        API019_BOARD_MAIN_NUM_PROJECTS,
        PRODUCTINFO_BOARD_MAIN_PROJECT_DATA
    }
};

// Do not delete this!
CT_ASSERT(ELEMENTS_IN_ARRAY(API019_BOARD_PROJECT_INFO) == API019_NUM_BOARDS);

#if (API019_BOARD_DATA_FEEDBACK == ENABLED)
    //! Define how many board types from external boards this application can handle
    //! Board Types from the same WIN address
    #define PRODUCTINFO_EXTERNAL_BOARDS_NUM             (1)     //eg: API019_BOARD_MAIN from ACU Node

    //! Define how many PROJECT IDs per board type this application can handle
    #define PRODUCTINFO_EXTERNAL_BOARD_PROJECTS_NUM     (2)     //eg: FIRMWARE and SETTING_FILE from ACU Node

    typedef struct
    {
        API019_BOARD_DATA_TYPE Data;
        API019_PROJECT_TYPE Project_IDs[PRODUCTINFO_EXTERNAL_BOARD_PROJECTS_NUM];   //!< This is a list with the Project IDs the external board has
    }PRODUCTINFO_EXTERNAL_BOARD_STRUCT_TYPE;

    //! Variables with information from other boards
    PRODUCTINFO_EXTERNAL_BOARD_STRUCT_TYPE External_Board[PRODUCTINFO_EXTERNAL_BOARDS_NUM];

    //! holds External Boards Project Data
    API019_PROJECT_DATA_TYPE External_Board_Project_Data[PRODUCTINFO_EXTERNAL_BOARDS_NUM][PRODUCTINFO_EXTERNAL_BOARD_PROJECTS_NUM];
#endif

//  --- Log Data ------------------------------------------------------------------------------------------------------
//! A list of log message IDs that are generated by this module.
typedef enum
{
    INVALID_PROJECT_DATA = 0,           //!< data: number of elements in the PROJECT_DATA array
    INVALID_BOARD,                      //!< data: board number
    INVALID_PROJECT                     //!< data: project number
} MODULE_PRODUCTINFO_LOG_MESSAGE_ID_TYPE;
#define MODULE_NAME MODULE_PRODUCTINFO  //!< The name of this module for use by the Log module.

//  --- Private Function Prototypes -----------------------------------------------------------------------------------

//=====================================================================================================================
//-------------------------------------- Public Functions -------------------------------------------------------------
//=====================================================================================================================
//---------------------------------------------------------------------------------------------------------------------
/**
 *  @brief      Gets the project data for board and project.
 *
 *  @param      API019_BOARD_TYPE board - WIN Node can contain multiple boards.
 *  @param      API019_PROJECT_TYPE project - Each board can contain multiple SW projects.
 *
 *  @return     API019_PROJECT_DATA_TYPE * pt
 *  @retval     Pointer to the project data for the specified board and project.
 *  @retval     NULL = invalid board and/or project passed
 */
API019_PROJECT_DATA_TYPE * ProductInfo__GetProjectData(API019_BOARD_TYPE board, API019_PROJECT_TYPE project)
{
    API019_PROJECT_DATA_TYPE * pt = NULL;

    if (board >= API019_NUM_BOARDS)
    {
        LOG_ADD_EXCEPTION(INVALID_BOARD, board);
    }
    else if (project >= API019_BOARD_PROJECT_INFO[board].Num_Of_Projects)
    {
        LOG_ADD_EXCEPTION(INVALID_PROJECT, project);
    }
    else
    {
        switch (board)
        {
            case API019_BOARD_MAIN:
                switch (project)
                {
                    case API019_PROJECT_FIRMWARE: // Firmware
                        memcpy(&Temp_Data,
                               &PRODUCTINFO_BOARD_MAIN_PROJECT_DATA[project],
                               sizeof(API019_PROJECT_DATA_TYPE));

                        Temp_Data.ClassB_CRC = (uint32)MICRO_FLASH_CRC;
                        pt = &Temp_Data;
                        break;
                    default:
                        break;
                }
                break;

            default:
                break;
        }
    }

    return (pt);
}

//---------------------------------------------------------------------------------------------------------------------
/**
 * @brief   Gets the total number of SW project specified for the passed board.
 *
 * @param   API019_BOARD_TYPE board - The board.
 *
 * @return  uint8 num_projects
 * @retval  > 0 - The total number of SW projects for the specified board.
 * @retval  0 - Invalid board.
 */
uint8 ProductInfo__GetNumProjects(API019_BOARD_TYPE board)
{
    uint8 num_projects = 0;
    if (board >= API019_NUM_BOARDS)
    {
        LOG_ADD_EXCEPTION(INVALID_BOARD, board);
    }
    else
    {
        num_projects = (API019_BOARD_PROJECT_INFO[board].Num_Of_Projects);
    }

    return (num_projects);
}

//---------------------------------------------------------------------------------------------------------------------
/**
 *  @brief      Returns the SW project IDs for board.
 *
 *  @param      API019_BOARD_TYPE board - board on the WIN Node
 *
 *  @return     API019_PROJECT_TYPE * pt
 *  @retval     Pointer to an array of project IDs on board.
 *  @retval     NULL - Invalid board.
 */
API019_PROJECT_TYPE *ProductInfo__GetProjectIDs(API019_BOARD_TYPE board)
{
    API019_PROJECT_TYPE * pt = NULL;

    if (board >= API019_NUM_BOARDS)
    {
        LOG_ADD_EXCEPTION(INVALID_BOARD, board);
    }
    else
    {
        switch (board)
        {
            case API019_BOARD_MAIN:
                pt = API019_BOARD_MAIN_PROJECTS;
                break;

            default:
                break;
        }
    }

    return (pt);
}

#if (API019_BOARD_DATA_FEEDBACK == ENABLED)
//---------------------------------------------------------------------------------------------------------------------
/**
 * @brief Handles opcode API019PRODUCTINFO_OP_REQ_PUB_BOARD_DATA feedback
 * @param node_id
 * @param board
 * @param board_data
 */
void ProductInfo__BoardDataFeedback(uint8 node_id,uint8 board ,API019_BOARD_DATA_TYPE *board_data, API019_PROJECT_TYPE *project_ids)
{
    //initialize the Project ID list with invalid IDs
    memset(&External_Board[board].Project_IDs, API019_PROJECT_NOT_AVAILABLE, PRODUCTINFO_EXTERNAL_BOARD_PROJECTS_NUM);

    if(node_id == WIN_ACU_ADDRESS)
    {
        if(board < PRODUCTINFO_EXTERNAL_BOARDS_NUM)
        {
            memcpy(&External_Board[board].Data, board_data, sizeof(API019_BOARD_DATA_TYPE));
            if(project_ids != NULL)
            {
                memcpy(&External_Board[board].Project_IDs, project_ids, External_Board[board].Data.Board_Num_Projects);
            }
        }
    }
}

//---------------------------------------------------------------------------------------------------------------------
/**
 * @brief Handles opcode API019PRODUCTINFO_OP_REQ_PUB_PROJECT_DATA feedback
 * @param node_id
 * @param board
 * @param project
 * @param project_data
 */
void ProductInfo__ProjectDataFeedback(uint8 node_id,uint8 board,API019_PROJECT_TYPE project,API019_PROJECT_DATA_TYPE *project_data)
{
    if(node_id == WIN_ACU_ADDRESS)
    {
        if(board < PRODUCTINFO_EXTERNAL_BOARDS_NUM)
        {
            if(project == API019_PROJECT_FIRMWARE)
            {
                memcpy(&External_Board_Project_Data[board][project], project_data, sizeof(API019_PROJECT_DATA_TYPE));
            }
            else if(project == API019_PROJECT_SETTINGFILE)
            {
                memcpy(&External_Board_Project_Data[board][1], project_data, sizeof(API019_PROJECT_DATA_TYPE));
            }
        }
    }
}
#endif

//=====================================================================================================================
//-------------------------------------- Private Functions ------------------------------------------------------------
//=====================================================================================================================
