/**
 *  @file       TriacMci.c
 *  @brief      Basic description of file contents
 *
 *  @details    Detailed description of the file contents
 *
 *---------------------------------------------------------------------------------------------------------------------
 *------------------- Copyright 2011.  Whirlpool Corporation.  All rights reserved - CONFIDENTIAL ---------------------
 *---------------------------------------------------------------------------------------------------------------------
 */

//-------------------------------------- Include Files ----------------------------------------------------------------
#include "C_Extensions.h"
#include "TriacMci.h"

#if (HBL_LOAD_NUM_TRIACMCI > 0)
#include "Mci.h"
#include "DigitalOutputPilot.h"
#include <string.h>
#include "VirtualPin.h"
#include "Log.h"
//-------------------------------------- PUBLIC (Variables) -----------------------------------------------------------

//-------------------------------------- PRIVATE (Variables, Constants & Defines) -------------------------------------
//! A list of log message IDs that are generated by this module.
typedef enum
{
    INVALID_VIRTUAL_PIN = 0     //!< data: the invalid virtual pin number being passed
} MODULE_TRIACMCI_MESSAGE_ID_TYPE;
#define MODULE_NAME MODULE_TRIACMCI       //!< The name of this module for use by the Log module.

PACKED typedef struct
{
    uint8                           Processed;                      //!< Processed value
    uint8                           Requested;                      //!< Requested value
} TRIACMCI_DATA_TYPE;

static TRIACMCI_DATA_TYPE TriacMci_Data[HBL_LOAD_NUM_TRIACMCI];
static uint8 TriacMci_Allocation;
//-------------------------------------- PRIVATE (Function Prototypes) ------------------------------------------------

static BOOL_TYPE GetVirtualPinNumber(HBL_LOAD_TYPE *load, uint8 *virtual_pin);
//=====================================================================================================================
//-------------------------------------- Public Functions -------------------------------------------------------------
//=====================================================================================================================

//---------------------------------------------------------------------------------------------------------------------
/**
 * @brief Initialize all instances of this load type.
 *        Initialize static RAM used by the module.
 * @return
 */
void TriacMci__Initialize(void)
{
    TriacMci_Allocation = 0;
    memset (TriacMci_Data , 0 , sizeof(TriacMci_Data));
}


//---------------------------------------------------------------------------------------------------------------------
/**
 * @brief Reserve memory for this load instance.
 * @return The index of the allocated load.
 */
uint8 TriacMci__Allocate(void)
{
    uint8 retval;
    retval = 0xFF;
    if (TriacMci_Allocation < (uint8)HBL_LOAD_NUM_TRIACMCI)
    {
        retval = TriacMci_Allocation;
        TriacMci_Allocation++;
    }
    return (retval);
}


//---------------------------------------------------------------------------------------------------------------------
/**
 * @brief  This InitializeInstance function is called after an instance has been allocated in order to initialize the load instance.
 * @param A pointer to the HBL_LOAD_TYPE structure with load and load instance information.
 * @return PASS if the load is successfully initialize; otherwise FAIL.
 *
 */
PASS_FAIL_TYPE TriacMci__InitializeInstance(HBL_LOAD_TYPE * load)
{
    PASS_FAIL_TYPE retval;
    retval = FAIL;

    if (load->Load_Data_Index < TriacMci_Allocation)
    {
        retval = PASS;
    }

    return (retval);
}

//---------------------------------------------------------------------------------------------------------------------
/**
 * @brief This function is called each time a new request is made to control the output hardware.
 *        It Update the requested state of the output controlled by this load instance.
 * @param load  A pointer to the HBL_LOAD_TYPE structure with load and load instance information.
 * @param data  A pointer to memory that contains the new requested load state.
 * @return PASS if the requested load state is successfully saved; otherwise FAIL.
 */
PASS_FAIL_TYPE TriacMci__Request(HBL_LOAD_TYPE * load,void * data)
{
	PASS_FAIL_TYPE retval;

	if (load->Load_Data_Index < TriacMci_Allocation)
    {
        TriacMci_Data[load->Load_Data_Index].Requested = *(uint8 *)data;
        retval = PASS;
    }
    else
    {
    	retval = FAIL;
    }

	return retval;
}

//---------------------------------------------------------------------------------------------------------------------
/**
 * @brief This function is called  when it is time to update the output hardware.
 *        This typically occurs every 100ms near the end of the application thread execution.
 * @param load  A pointer to the HBL_LOAD_TYPE structure with load and load instance information.
 * @return PASS if the controlled outputs are successfully updated; otherwise FAIL.
 */
PASS_FAIL_TYPE TriacMci__Process(HBL_LOAD_TYPE * load , HBL_PILOT_HANDLER_HOOK_TYPE * pilot)
{
    uint8 virtual_pin;

    if (load->Load_Data_Index < (uint8)HBL_LOAD_NUM_TRIACMCI)
    {
        TriacMci_Data[load->Load_Data_Index].Processed = TriacMci_Data[load->Load_Data_Index].Requested;
        if(HBL_PILOT_TRIAC == load->Pilot_Type)
        {
            if(TriacMci_Data[load->Load_Data_Index].Processed != (uint8)0)
            {
            	(void)MCI_RUN(MOTOR0);
            }
            else
            {
            	(void)MCI_STOP(MOTOR0);
            }
        }
        else
        {
            if (((uint8)GetVirtualPinNumber(load, &virtual_pin) == (uint8)TRUE) &&
                    (VIRTUALPIN_TABLE[virtual_pin].port != PORT_NULL))
            {
                uint8 pin_val = TriacMci_Data[load->Load_Data_Index].Requested;
                // Invert pin value according to Hi Low Activation Bitmap
                pin_val ^= ~load->Hi_Low_Activation_Bitmap;
                pin_val &= (uint8)0x01;

                Gpio__PinWrite(VIRTUALPIN_TABLE[virtual_pin].port, VIRTUALPIN_TABLE[virtual_pin].pin, (BOOL_TYPE)pin_val);
            }
        }
    }
    return (PASS);
}


//---------------------------------------------------------------------------------------------------------------------
/**
 * @brief This function get the requested state of the output controlled by this load instance.
 * @param load A pointer to the HBL_LOAD_TYPE structure with load and load instance information.
 * @return This function return the requested state of the output.
 */
void * TriacMci__GetRequested(HBL_LOAD_TYPE * load)
{
    void *retval;

    if (load->Load_Data_Index < TriacMci_Allocation)
    {
    	retval = (void *) &TriacMci_Data[load->Load_Data_Index].Requested;
    }
    else
    {
    	retval = NULL;
    }

	return retval;
}


//---------------------------------------------------------------------------------------------------------------------
/**
 * @brief This function get the state of the output controlled by this load instance.
 * @param load A pointer to the HBL_LOAD_TYPE structure with load and load instance information.
 * @return This function return the the state of the output.
 */
void * TriacMci__GetProcessed(HBL_LOAD_TYPE * load , HBL_PILOT_HANDLER_HOOK_TYPE * pilot)
{
    void *retval;

	if (load->Load_Data_Index < TriacMci_Allocation)
    {
		retval = ((void *) &TriacMci_Data[load->Load_Data_Index].Processed);
    }
    else
    {
    	retval = (NULL);
    }

	return retval;
}


//---------------------------------------------------------------------------------------------------------------------
/**
 * @brief This function handle the behaviors that must be implemented periodically by this load instance.
 *        This function is called every 5ms.
 * @param load A pointer to the HBL_LOAD_TYPE structure with load and load instance information.
 * @return PASS if this function handle the behaviors successfully; otherwise FAIL.
 */
PASS_FAIL_TYPE TriacMci__AsyncProcess(HBL_LOAD_TYPE * load , HBL_PILOT_HANDLER_HOOK_TYPE * pilot)
{
    PASS_FAIL_TYPE retval;

    retval = FAIL;
    if (load->Load_Data_Index < TriacMci_Allocation)
    {
        retval = PASS;
    }

    return retval;
}


//---------------------------------------------------------------------------------------------------------------------
/**
 * @brief This function get the status of this load instance.
 * @param load A pointer to the HBL_LOAD_TYPE structure with load and load instance information.
 * @return This function return the status of the load.
 */
void * TriacMci__GetStatus(HBL_LOAD_TYPE * load , HBL_PILOT_HANDLER_HOOK_TYPE * pilot)
{
    void *retval;

    if (load->Load_Data_Index < TriacMci_Allocation)
    {
    	retval = (void *) &TriacMci_Data[load->Load_Data_Index].Processed;
    }
    else
    {
    	retval = NULL;
    }

    return retval;
}


//=====================================================================================================================
//-------------------------------------- Private Functions ------------------------------------------------------------
//=====================================================================================================================

static BOOL_TYPE GetVirtualPinNumber(HBL_LOAD_TYPE *load, uint8 *virtual_pin)
{
    BOOL_TYPE ret_val = TRUE;
    *virtual_pin = load->Pin_Ptr[0];
    if ( *virtual_pin >= VirtualPin__GetNumOf() )
    {
        LOG_ADD_EXCEPTION(INVALID_VIRTUAL_PIN, *virtual_pin);
        ret_val = FALSE;
    }
    return (ret_val);
}

#endif
