/**
 *  @file		HeatMonitor.c
 *
 *  @brief		A monitor that checks the conditions to force the heater off.
 *
 *  @details    There are several requirements that require the heater's deactivation to prevent damages.
 *  			This monitor evaluates the required conditions and, if any of them is satisfied, forces the heater off, with a
 *  			higher priority than the Heat and Loads Control processes.
 *  			It has to be called as a POST MONITOR, so that it has all the updated information on the state requested for the
 *  			heater by the processes, and after WashHeaterFaultMonitor__Execution(), so that it has the updated information
 *  			on the heater being disabled due to a fault.
 *
 *
 *  @copyright  Copyright 2017-$Date$. Whirlpool Corporation. All rights reserved - CONFIDENTIAL
 */
//---------------------------------------------------------------------------------------------------------------------
//---------------------------------------------------------------------------------------------------------------------


//-------------------------------------- Include Files ----------------------------------------------------------------
// -- This Module --
#include "SystemConfig.h"
#include "HeatMonitor.h"

// -- Other Modules --
#include "Condition.h"
#include "DishAuxVar.h"
#include "DoorMonitor.h"
#include "Interpreter.h"
#include "Hbl.h"
#include "HeaterLoad.h"
#include "HotHighPotMonitor.h"
#include "Log.h"
#if (API221_CLIENT_FEATURE == ENABLED)
#include "McuGetDataMonitor.h"
#endif /* (API221_CLIENT_FEATURE == ENABLED) */
#include "Micro.h"
#include "Selector.h"
#include "SettingFile.h"
#include "StabilityControl.h"
#include "VWI.h"
#include "WashHeaterFaultMonitor.h"

//-------------------------------------- PUBLIC (Variables) -----------------------------------------------------------

//-------------------------------------- PRIVATE (Variables, Constants & Defines) -------------------------------------
//! The name of this module for use by the Log module.
#define MODULE_NAME MODULE_HEAT_MONITOR

//! Displacement value that indicates that the feature is not used.
#define UNUSED_FEATURE 0xFFU

//! The number of times that the HeatMonitor__Execution function will be called every second while running.
#define HEAT_MONITOR_CALLS_PER_SECOND 10U

//! A list of log message IDs that are generated by this module.
typedef enum MODULE_HEAT_MONITOR_LOG_MESSAGE_ID_ENUM
{
	ERROR_LOADING_PARAMETERS       = 1,
} MODULE_HEAT_MONITOR_LOG_MESSAGE_ID_TYPE;

typedef struct HEAT_MONITOR_DATA_STRUCT
{
	//! Down counter for the activation delay
	uint16 Activation_Delay_Counter;
	//! Down counter for WS_WATER state
	uint16 Stable_Water_Ctr;
	//! Time VWI_Status has to be continuously WS_WATER
	uint16 Stable_Water_Time;
	//! Minimum RPM the motor must be running at to turn off the pump Integrated heater.
	uint16 Heater_Turn_Off_Speed;
	//! Minimum RPM the motor must be running at to turn on the pump Integrated heater.
	uint16 Heater_Turn_On_Speed;
	//! Displacement of the deactivation condition in the Condition Table Data pointer.
	uint8 Condition_Index;
	//! Heater Type (Calrod/Integrated)
	uint8 Heater_Type;
	//! Delay time for heater to turn back on. Units == seconds.
	uint8 Heater_Activation_Delay;
	//! The state requested by the Interpreter for the heater in the previous iteration.
	uint8 Previous_Requested_State;
	//! True if the heater was being forced off in the previous iteration due to the VWI State
	BOOL_TYPE VWI_Was_Forcing_Heater_Off;
	//! True if the heater was being forced off in the previous iteration due to the wash Pump state
	BOOL_TYPE Wash_Pump_Was_Forcing_Heater_Off;
} HEAT_MONITOR_DATA_TYPE;

//! Data structure for the monitor's management
static HEAT_MONITOR_DATA_TYPE Heat_Monitor_Data;

//! TRUE if the Washing Heater is requested on by the cycle (processes, ...) and the deactivation condition in FALSE.
static BOOL_TYPE Heater_Requested;
//! TRUE if Washing Heater is allowed to be On by everything except VWI value (activation delay, door status, drain pump status, ...).
static BOOL_TYPE Heater_Allowed;
//! TRUE if Washing Heater is allowed to be on by VWI value.
static BOOL_TYPE Heater_VWI_Allowed;
// Pointer to the status of heater load Invert_Pin_Sequence for washing resistor.
static BOOL_TYPE *Inverted_Sequence_Status_Ptr;


//-------------------------------------- PRIVATE (Function Prototypes) ------------------------------------------------
static BOOL_TYPE IsVWIRequestingHeaterOff(void);
static BOOL_TYPE IsWashPumpRequestingHeaterOff(void);

//=====================================================================================================================
//-------------------------------------- Public Functions -------------------------------------------------------------
//=====================================================================================================================


/**
 * It initializes the Heat Monitor and its data.
 *
 * @return None
 *
 */
void HeatMonitor__Initialize(void)
{
    SETTINGFILE_LOADER_TYPE loader;

    if (Micro__GetResetMode() == MICRO_RESET_MODE_COLD)
    {
    	Heat_Monitor_Data.Previous_Requested_State = OFF;
    	Heat_Monitor_Data.Activation_Delay_Counter = 0;
    	Heat_Monitor_Data.Stable_Water_Ctr = 0;
    	Heat_Monitor_Data.VWI_Was_Forcing_Heater_Off = TRUE; // Assuming worst case if first VWI value is WS_UNSTABLE_WATER
    	Heat_Monitor_Data.Wash_Pump_Was_Forcing_Heater_Off = FALSE;

		// Default initialization for setting file parameters, values are chosen so that they have no effect on the heater
    	Heat_Monitor_Data.Condition_Index = UNUSED_FEATURE;
    	Heat_Monitor_Data.Heater_Activation_Delay = 0;
    	Heat_Monitor_Data.Heater_Type = CALROD_HEATER;// It is not affected neither by VWI nor by wash pump state
    	Heat_Monitor_Data.Heater_Turn_Off_Speed = 0; // If the parameter is not present in setting file, this value guarantees that, if there is a variable speed wash pump,
													 // heater is turned off when the wash pump is off (that is its speed is <= 0), a requirement independent from the speed
													 // thresholds.
    	Heat_Monitor_Data.Heater_Turn_On_Speed = 0;	// Heater is never forced off
		Heat_Monitor_Data.Stable_Water_Time = 0;

		Heater_Requested = FALSE;
		Heater_Allowed = FALSE;
		Heater_VWI_Allowed = FALSE;

		// Get the Heat Monitor process parameters from the setting file.
		if (SettingFile__BasicLoader(SF_PTR_ACU_PRODUCT_CONFIGURATION_DATA,
									DISPL_HEATER_DEACTIVATION_CONDITIONS_PARAM,
									&loader) == PASS)
		{
			// Read the setting file data into local variables for convenience.
			Heat_Monitor_Data.Condition_Index = ((HEAT_MONITOR_INSTANCE_TYPE *)(void*)loader.Data)->Condition_Index;
			Heat_Monitor_Data.Heater_Activation_Delay = ((HEAT_MONITOR_INSTANCE_TYPE *)(void*)loader.Data)->Heater_Activation_Delay;
			Heat_Monitor_Data.Heater_Type = ((HEAT_MONITOR_INSTANCE_TYPE *)(void*)loader.Data)->Heater_Type;
			if (loader.Length >= sizeof(HEAT_MONITOR_INSTANCE_TYPE))
			{
				Heat_Monitor_Data.Heater_Turn_Off_Speed = ENDIANU16_STON(((HEAT_MONITOR_INSTANCE_TYPE *)(void*)loader.Data)->Heater_Turn_Off_Speed);
				Heat_Monitor_Data.Heater_Turn_On_Speed = ENDIANU16_STON(((HEAT_MONITOR_INSTANCE_TYPE *)(void*)loader.Data)->Heater_Turn_On_Speed);
			}
		}
		else
		{
			LOG_ADD_EXCEPTION(ERROR_LOADING_PARAMETERS, SF_PTR_ACU_PRODUCT_CONFIGURATION_DATA);
		}

		// Get Stable_Water_Time from Stability Control common parameters in setting file
		if (SettingFile__BasicLoader(SF_PTR_ACU_ALGORITHM_PARAMETERS, DISPL_STABILITY_CONTROL, &loader) == PASS)
		{
			Heat_Monitor_Data.Stable_Water_Time = (((const STABILITY_CONTROL_COMMON_PARAMS_TYPE *)(void*)(loader.Data))->Water_Present_Time_x2) * (HEAT_MONITOR_CALLS_PER_SECOND/2U);
		}
		else
		{
			LOG_ADD_EXCEPTION(ERROR_LOADING_PARAMETERS, SF_PTR_ACU_ALGORITHM_PARAMETERS);
		}

		// Get a pointer to Invert_Pin_Sequence field of Wash Heater heater load
		Inverted_Sequence_Status_Ptr = HeaterLoad__GetInvertedSequenceStatusByLoadId(HBL_LOAD_WASHING_HEATER);
    }
}


//----------------------------------------------------------------------------
/**
 * It implements the execution of the Heat Monitor.
 *
 * @return None
 *
 */
void HeatMonitor__Execution(void)
{
	uint8 current_requested_state;
	uint8 *current_state_ptr;
	BOOL_TYPE is_condition_requesting_heater_off;
	BOOL_TYPE is_wash_pump_requesting_heater_off;
	CYCLE_GROUP_TYPE cycle_group;

	// Check if setting file condition is requesting heater OFF
	if ((UNUSED_FEATURE != Heat_Monitor_Data.Condition_Index) && (CONDITION_LEGACY_EVAL(Heat_Monitor_Data.Condition_Index) == CONDITION_RESULT_TRUE))
	{
		is_condition_requesting_heater_off = TRUE;
	}
	else
	{
		is_condition_requesting_heater_off = FALSE;
	}

	// Current requested state for the heater
	current_requested_state = OFF;
	current_state_ptr = (uint8*)Hbl__GetRequestedLoad(Hbl__GetLoadIndexByLoadID(HBL_LOAD_WASHING_HEATER));

	if (current_state_ptr != NULL)
	{
		current_requested_state = *current_state_ptr;
	}

	// Activation delay setup and Heater_Requested update
	if (current_requested_state == 1U)
	{
		if (is_condition_requesting_heater_off == FALSE)
		{
			// Heater_Requested is TRUE if the requested state is ON and deactivation condition is FALSE
			Heater_Requested = TRUE;
		}
		else
		{
			Heater_Requested = FALSE;
		}

		if (Heat_Monitor_Data.Previous_Requested_State == 0U)
		{
			// An activation request for the heater has been triggered
			Heat_Monitor_Data.Activation_Delay_Counter = (uint16)Heat_Monitor_Data.Heater_Activation_Delay * HEAT_MONITOR_CALLS_PER_SECOND;
		}
	}
	else
	{
		Heater_Requested = FALSE;

		Heat_Monitor_Data.Activation_Delay_Counter = 0;
	}

	Heat_Monitor_Data.Previous_Requested_State = current_requested_state;

	// Heater_VWI_Allowed update
	if (((uint8)IsVWIRequestingHeaterOff() == (uint8)TRUE) && (Heat_Monitor_Data.Heater_Type == (uint8)INTEGRATED_HEATER))
	{
		Heater_VWI_Allowed = FALSE;
	}
	else
	{
		Heater_VWI_Allowed = TRUE;
	}

	cycle_group = Selector__GetCycleGroup(0, COMPARTMENT_DEFAULT, Interpreter__GetCurrentStatement(COMPARTMENT_DEFAULT).Cycle);

	is_wash_pump_requesting_heater_off = IsWashPumpRequestingHeaterOff();

	// Heater_Allowed update. Heater_Allowed is FALSE if:
	// 1. Switching on has been requested but Heater_Activation_Delay has not expired yet and an EOL cycle is not active.
	//	OR
	// 2. Door is open
	//	OR
	// 3. (Drain Pump is on) AND (neither an EOL nor a Service cycle is active).
	//	OR
	// 4. (Heater is Integrated type) AND (Wash motor is off or under the requested speed).
	//  OR
	// 5. A heater failure has been detected by Wash Heater Fault Monitor
	//  OR
	// 6. Heater has to be temporarily forced off to check if a heater open failure is present
	if (((Heat_Monitor_Data.Activation_Delay_Counter > 0U) && (cycle_group != CYCLE_GROUP_EOL_TEST))
		|| (DoorMonitor__GetDoorStatus() == DOOR_STATUS_OPEN)
		|| (((uint8)DishAuxVar__IsDrainPumpOn() == (uint8)TRUE) && (cycle_group != CYCLE_GROUP_EOL_TEST) && (cycle_group != CYCLE_GROUP_SERVICE))
		|| ((Heat_Monitor_Data.Heater_Type == (uint8)INTEGRATED_HEATER) && ((uint8)is_wash_pump_requesting_heater_off == (uint8)TRUE))
		|| (WashHeaterFaultMonitor__GetDisabledBitmap() != 0U))
	{
		Heater_Allowed = FALSE;
	}
	else
	{
		Heater_Allowed = TRUE;
	}

	// Heater has to be turned off if:
	// 1. Setting file deactivation condition is TRUE.
	//	OR
	// 2. Heater_VWI_Allowed is FALSE.
	//	OR
	// 3. Heater_Allowed is FALSE
	//
	// To turn heater off the requested state is set to OFF. Anyway, during the transient due to the activation delay,
	// instead of requesting the OFF state, the HDOM2_LOAD_STATE_PIN_1 state is requested (line relay on - neutral relay
	// off): the physical state of the heater will still be off, but this condition is used to test specific heater failures.

	if (((uint8)is_condition_requesting_heater_off == (uint8)TRUE) || (Heater_VWI_Allowed == FALSE) || (Heater_Allowed == FALSE))
    {
		uint8 heater_state = (uint8)OFF; // Default: heater requested state == OFF;

		if (Hbl__GetPilotIDByIndex(Hbl__GetLoadIndexByLoadID(HBL_LOAD_WASHING_HEATER)) == HBL_PILOT_DIGITAL_OUTPUT_MULTI_2_PIN)
		{
			uint8 relay_test_end = 0;

			if (Inverted_Sequence_Status_Ptr != NULL)
			{
				if (*Inverted_Sequence_Status_Ptr == FALSE)
				{
					// In this specific condition the (line relay on - neutral relay off) state is not requested
					// in the last 100 ms of the delay, because it would prevent the correct relays turning on
					// sequence from being applied.
					relay_test_end = 1;
				}
			}

			if (((Heat_Monitor_Data.Activation_Delay_Counter > relay_test_end) && (cycle_group != CYCLE_GROUP_EOL_TEST))
				&& (DoorMonitor__GetDoorStatus() == DOOR_STATUS_CLOSE)
				&& (WashHeaterFaultMonitor__GetDisabledBitmap() == 0U))
			{
				heater_state = (uint8)HDOM2_LOAD_STATE_PIN_1;
			}
		}

        (void)Hbl__SetLoadRequestByLoadID(HBL_LOAD_WASHING_HEATER, HBL_PRIORITY_HEAT_MONITOR, &heater_state);
    }

	if (Heat_Monitor_Data.Activation_Delay_Counter > 0U)
	{
		Heat_Monitor_Data.Activation_Delay_Counter--;
	}
}


/**
 * It returns the value of Heater_Requested.
 *
 * @return Heater_Requested (FALSE/TRUE)
 */
BOOL_TYPE HeatMonitor__IsHeaterRequested(void)
{
	return Heater_Requested;
}


/**
 * It returns the value of Heater_Allowed.
 *
 * @return Heater_Allowed (FALSE/TRUE)
 */
BOOL_TYPE HeatMonitor__IsHeaterAllowed(void)
{
	return Heater_Allowed;
}


/**
 * It returns the value of Heater_VWI_Allowed.
 *
 * @return Heater_VWI_Allowed (FALSE/TRUE)
 */
BOOL_TYPE HeatMonitor__IsHeaterVWIAllowed(void)
{
	return Heater_VWI_Allowed;
}

//=====================================================================================================================
//-------------------------------------- Private Functions ------------------------------------------------------------
//=====================================================================================================================

/**
 * It returns if the heater has to be turned off due to the state of VWI
 *
 * @retval TRUE/FALSE
 */
static BOOL_TYPE IsVWIRequestingHeaterOff(void)
{
	BOOL_TYPE ret_value;
	VWI_WATER_SENSE_TYPE vwi_status;

	ret_value = FALSE;

	vwi_status = Vwi__GetWaterStatus();

	// VWI Instability detection
	if ((vwi_status == WS_NO_WATER) || (vwi_status == WS_UNSTABLE_NO_WATER) || (vwi_status == WS_NOT_VALID))
	{
		Heat_Monitor_Data.Stable_Water_Ctr = Heat_Monitor_Data.Stable_Water_Time;
		ret_value = TRUE;
	}
	else if (vwi_status == WS_UNSTABLE_WATER)
	{
		if ((uint8)Heat_Monitor_Data.VWI_Was_Forcing_Heater_Off == (uint8)TRUE)
		{
			Heat_Monitor_Data.Stable_Water_Ctr = Heat_Monitor_Data.Stable_Water_Time;
			ret_value = TRUE;
		}
	}
	else if (vwi_status == WS_WATER)
	{
		if (Heat_Monitor_Data.Stable_Water_Ctr > 0U)
		{
			Heat_Monitor_Data.Stable_Water_Ctr --;
			ret_value = TRUE;
		}
	}
	else
	{
		// Do nothing
	}

	Heat_Monitor_Data.VWI_Was_Forcing_Heater_Off = ret_value;

	return ret_value;
}


/**
 * It returns if the heater has to be turned off due to the state of wash pump
 *
 * @retval TRUE/FALSE
 */
static BOOL_TYPE IsWashPumpRequestingHeaterOff()
{
	BOOL_TYPE ret_value;
	uint8 wash_pump_index;
	uint8 *wash_pump_state_ptr;
	HBL_PILOT_ENUM_TYPE wash_pump_pilot_type;

	ret_value = FALSE;

	wash_pump_index = Hbl__GetLoadIndexByLoadID(HBL_LOAD_WASH_PUMP);
	wash_pump_pilot_type = Hbl__GetPilotIDByIndex(wash_pump_index);

	if (wash_pump_pilot_type != HBL_PILOT_INVALID)
	{
		if (wash_pump_pilot_type == HBL_PILOT_EXTERNAL_MOTOR)
		{
#if (API221_CLIENT_FEATURE == ENABLED)
			if ((McuGetDataMonitor__GetWashPumpSpeed() <= Heat_Monitor_Data.Heater_Turn_Off_Speed) ||
				((McuGetDataMonitor__GetWashPumpSpeed() < Heat_Monitor_Data.Heater_Turn_On_Speed) && ((uint8)Heat_Monitor_Data.Wash_Pump_Was_Forcing_Heater_Off == (uint8)TRUE)))
			{
				ret_value = TRUE;
			}
#endif /* (API221_CLIENT_FEATURE == ENABLED) */
		}
		else
		{
			wash_pump_state_ptr = (uint8 *)Hbl__GetProcessedLoad(wash_pump_index);
			if ((wash_pump_state_ptr != (uint8*)NULL) && (*wash_pump_state_ptr == 0U))
			{
				ret_value = TRUE;
			}
		}
	}

	Heat_Monitor_Data.Wash_Pump_Was_Forcing_Heater_Off = ret_value;

	return ret_value;
}
