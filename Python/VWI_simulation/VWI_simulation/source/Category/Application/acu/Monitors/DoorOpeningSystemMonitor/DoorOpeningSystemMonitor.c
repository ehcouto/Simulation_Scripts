/**
 *  @file		DoorOpeningSystemMonitor.c
 *
 *  @brief		A monitor that manages the Door Opening System device, together with the DOS Push and DOS Pull tasks.
 *
 *  @details    Door Opening System (briefly DOS) is a device used to assist with the drying by opening the door of the dishwasher
 *  			releasing the moisture out of the tub at selected moment given by the cycle design.
 *  			Door Opening System monitor is used for the DOS overall management, and exchanges data with the DOS Push
 *  			and DOS Pull tasks, that are used to trigger the activation of the Push and of the Pull sequences.
 *
 */

//  --- Include Files -------------------------------------------------------------------------------------------------

// -- This Module --
#include "C_Extensions.h"
#include "DoorOpeningSystemMonitor.h"

// -- Other Modules --
#include "DishAuxVar.h"
#include "DoorMonitor.h"
#include "DoorOpeningSystemPush.h"
#include "Hbl.h"
#include "Log.h"
#include "Micro.h"
#include "NVData.h"

//-------------------------------------- PUBLIC (Variables) -----------------------------------------------------------

//-------------------------------------- PRIVATE (Variables, Constants & Defines) -------------------------------------
//! The name of this module to be used by the Log module.
#define MODULE_NAME MODULE_DOOR_OPENING_SYSTEM_MONITOR

//! A list of log message IDs that are generated by this module.
typedef enum MODULE_DOOR_OPENING_SYSTEM_MONITOR_LOG_MESSAGE_ID_ENUM
{
	ERROR_MISSING_PARAMETERS  = 1,
} MODULE_DOOR_OPENING_SYSTEM_MONITOR_LOG_MESSAGE_ID_TYPE;

//! The number of times that the DoorOpeningSystemMonitor__Execution function will be called every second while running.
#define DOS_MONITOR_CALLS_PER_SECOND 	10U

//! States of the Dos Pin State
typedef enum DOS_PIN_STATE_ENUM
{
	DOS_PIN_NOT_INIT = 0,
	DOS_PIN_FULLY_RETRACTED,
	DOS_PIN_EXTRACTING,
	DOS_PIN_RETRACTING,
	DOS_PIN_FULLY_EXTRACTED
} DOS_PIN_STATE_TYPE;

typedef struct DOOR_OPENING_SYSTEM_NV_DATA_STRUCT
{
	BOOL_TYPE Door_Opened_By_DOS; //! TRUE if, when the door is open, we can assume that it has been opened by the Door Opening System
	DOS_PUSH_STATE_TYPE Push_State; //! State of the DOS Push procedure
	DOS_PULL_STATE_TYPE Pull_State; //! State of the DOS Pull procedure
} DOOR_OPENING_SYSTEM_NV_DATA_TYPE;

typedef struct DOOR_OPENING_SYSTEM_DATA_STRUCT
{
	DOS_PIN_STATE_TYPE DOS_Pin_State; //! State of the DOS pin
	uint16 DOS_Pull_Counter; //! Timer used to manage the DOS PULL procedure
	DOOR_OPENING_SYSTEM_SF_PARAMS_TYPE *SF_DOS_Params_Ptr; //! Pointer to setting file parameters for DOS
} DOOR_OPENING_SYSTEM_DATA_TYPE;

//! Non Volatile data for Door Opening System management
#pragma location = "_appliance_segment"
static DOOR_OPENING_SYSTEM_NV_DATA_TYPE DOS_NV_Data;

//! Volatile data for Door Opening System management
static DOOR_OPENING_SYSTEM_DATA_TYPE DOS_Data;

//-------------------------------------- PRIVATE (Function Prototypes) ------------------------------------------------
static void UpdateDOSPinState(void);


//=====================================================================================================================
//-------------------------------------- Public Functions -------------------------------------------------------------
//=====================================================================================================================


//----------------------------------------------------------------------------
/**
 * It initializes the Door Opening System Monitor and its data.
 * It loads data from setting file and checks if Push or Pull sequence restart is needed after a reset.
 *
 * @return None
 *
 */
void DoorOpeningSystemMonitor__Initialize(void)
{
	SETTINGFILE_LOADER_TYPE loader;

	if (Micro__GetResetMode() == MICRO_RESET_MODE_COLD)
	{
		DOS_Data.SF_DOS_Params_Ptr = (DOOR_OPENING_SYSTEM_SF_PARAMS_TYPE *)NULL;
		DOS_Data.DOS_Pin_State = DOS_PIN_NOT_INIT;
		DOS_Data.DOS_Pull_Counter = 0;

		if (Hbl__GetLoadIndexByLoadID(HBL_LOAD_DOOR_OPENING_SYSTEM) != (uint8)HBL_INDEX_INVALID)
		{
			// Get the DOS parameters from the setting file.
			if (SettingFile__BasicLoader(SF_PTR_ACU_ALGORITHM_PARAMETERS, DSPL_DOOR_OPENING_SYSTEM, &loader) == PASS)
			{
				DOS_Data.SF_DOS_Params_Ptr = (DOOR_OPENING_SYSTEM_SF_PARAMS_TYPE *)(void*)loader.Data;
			}
			else
			{
				// Algorithm parameters missing, allow step advancement
				LOG_ADD_EXCEPTION(ERROR_MISSING_PARAMETERS, DSPL_DOOR_OPENING_SYSTEM);
			}
		}
		else
		{
			// Door Opening System not present
		}

		if (NVData__GetLastRestoreStatus()->Bit.Appliance_Data_Recovered != (NVDATA_RESTORE_TYPE)NVDATA_RESTORE_OKAY)
		{
			DOS_NV_Data.Door_Opened_By_DOS = FALSE;
			DOS_NV_Data.Push_State = DOS_PUSH_COMPLETE;
			if (DOS_Data.SF_DOS_Params_Ptr != NULL)
			{
				DoorOpeningSystemMonitor__StartPull(DOS_Data.SF_DOS_Params_Ptr->Pull_Off_Time); // If NV Data are corrupted execute Pull procedure
			}
			else
			{
				DOS_NV_Data.Pull_State = DOS_PULL_COMPLETE;
			}
		}
	}
	else
	{
		if (DOS_Data.SF_DOS_Params_Ptr != NULL)
		{
			if (DOS_NV_Data.Push_State != DOS_PUSH_COMPLETE)
			{
				// If Push procedure has been interrupted by a warm reset it has to be restarted
				DoorOpeningSystemPush__StartPush(DOS_Data.SF_DOS_Params_Ptr->Push_Pre_On_Time);
			}
		}
	}

	if (DOS_Data.SF_DOS_Params_Ptr != NULL)
	{
		if ((DOS_NV_Data.Pull_State == DOS_PULL_OFF_STEP) || (DOS_NV_Data.Pull_State == DOS_PULL_ON_STEP))
		{
			// If Pull procedure was interrupted by a reset it has to be restarted
			DoorOpeningSystemMonitor__StartPull(DOS_Data.SF_DOS_Params_Ptr->Pull_Off_Time);
		}

		// Update DOS_Pin_State
		UpdateDOSPinState();
	}
}


//----------------------------------------------------------------------------
/**
 * It implements the execution of the Door Opening System Monitor.
 * It manages the execution of the Pull sequence (that can be started either by DOS Pull task or
 * inside RunExit) and updates the DOS_Pin_State.
 * The Pull sequence consists of 2 sequential steps, whose duration is specified by setting file parameters:
 * - Off: the DOS output is driven off.
 * - On: the DOS output is driven on.
 * This sequence is processed by the DOS device controller to pull in the device pin.
 *
 * @return None
 *
 */
void DoorOpeningSystemMonitor__Execution(void)
{
	if (DOS_Data.SF_DOS_Params_Ptr != NULL)
	{
		ON_OFF_TYPE dos_pin_state;

		// Execute DOS Pull Procedure
		if (DOS_Data.DOS_Pull_Counter > 0U)
		{
			DOS_Data.DOS_Pull_Counter --;
		}

		switch(DOS_NV_Data.Pull_State)
		{
			case DOS_PULL_OFF_STEP:
				if (DOS_Data.DOS_Pull_Counter > 0U)
				{
					dos_pin_state = OFF;
					(void)Hbl__SetLoadRequestByLoadID(HBL_LOAD_DOOR_OPENING_SYSTEM, HBL_PRIORITY_DOOR_OPENING_SYSTEM, (uint8 *) &dos_pin_state);	//lint !e928 Suppress Info: cast from pointer to pointer [MISRA 2004 Rule 11.4]
					break;
				}
				else
				{
					DOS_Data.DOS_Pull_Counter = (uint16)DOS_Data.SF_DOS_Params_Ptr->Pull_On_Time * DOS_MONITOR_CALLS_PER_SECOND;
					DOS_NV_Data.Pull_State = DOS_PULL_ON_STEP;
				}
			//lint -fallthrough
			case DOS_PULL_ON_STEP:
				if (DOS_Data.DOS_Pull_Counter > 0U)
				{
					dos_pin_state = ON;
					(void)Hbl__SetLoadRequestByLoadID(HBL_LOAD_DOOR_OPENING_SYSTEM, HBL_PRIORITY_DOOR_OPENING_SYSTEM, (uint8 *) &dos_pin_state);	//lint !e928 Suppress Info: cast from pointer to pointer [MISRA 2004 Rule 11.4]
				}
				else
				{
					DOS_NV_Data.Pull_State = DOS_PULL_COMPLETE;
				}
				break;

			default:
				// Includes DOS_PULL_COMPLETE
				break;
		}


		// Update Door_Opened_By_DOS
		if ((DOS_NV_Data.Push_State == DOS_PUSH_COMPLETE) && (DoorMonitor__GetDoorStatus() == DOOR_STATUS_CLOSE))
		{
			DOS_NV_Data.Door_Opened_By_DOS = FALSE;
		}

		// Update DOS_Pin_State
		UpdateDOSPinState();

		// Update DOS Driven bit for HMI
		if ((DOS_NV_Data.Push_State != DOS_PUSH_COMPLETE) ||
			(DOS_NV_Data.Pull_State == DOS_PULL_OFF_STEP) ||
			(DOS_NV_Data.Pull_State == DOS_PULL_ON_STEP))
		{
			DishAuxVar__SetGenericBitmapBit(DOS_DRIVEN, ON);
		}
		else
		{
			DishAuxVar__SetGenericBitmapBit(DOS_DRIVEN, OFF);
		}

	}
}


//----------------------------------------------------------------------------
/**
 * It is called inside RUN_EXIT macro.
 * When the supervisor exits from the RUN state, this function checks if a DOS Pull sequence is required, and if so
 * it makes it start.
 *
 * @return None
 *
 */
void DoorOpeningSystemMonitor_CheckIfPullNeeded(void)
{
    SETTINGFILE_LOADER_TYPE loader;

	// Check if Pull Procedure is needed
	if (DOS_NV_Data.Pull_State == DOS_PULL_REQUIRED )
	{
		// Check if DOS Load is present in setting file
		if (Hbl__GetLoadIndexByLoadID(HBL_LOAD_DOOR_OPENING_SYSTEM) != (uint8)HBL_INDEX_INVALID)
		{
			// Check if the DOS Pull parameters are present in the setting file.
			if (SettingFile__BasicLoader(SF_PTR_ACU_ALGORITHM_PARAMETERS, DSPL_DOOR_OPENING_SYSTEM, &loader) == PASS)
			{
				DoorOpeningSystemMonitor__StartPull(((DOOR_OPENING_SYSTEM_SF_PARAMS_TYPE *)(void*)loader.Data)->Pull_Off_Time);
			}
		}
	}
}


/**
 * It sets up data to start the DOS Pull sequence.
 *
 * @param  time = the duration of the first step of the Pull sequence (in seconds)
 *
 * @return  None
 */
void DoorOpeningSystemMonitor__StartPull(uint8 time)
{
	DOS_Data.DOS_Pull_Counter = ((uint16)time * DOS_MONITOR_CALLS_PER_SECOND) + 1U; // the +1 is to account for the first decrement inside DoorOpeningSystemMonitor__Execution
	DOS_NV_Data.Push_State = DOS_PUSH_COMPLETE;
	DOS_NV_Data.Pull_State = DOS_PULL_OFF_STEP;
}


/**
 * It returns TRUE if, when the door is opened, we can assume that it has been opened by the DOS device.
 *
 * @return  the status of the DOS device
 * @retval TRUE = value set when the Push sequence is started
 * @retval FALSE = value set as default (when NV data are corrupted) and when the door is closed, after the completion of the Push procedure.
 */
BOOL_TYPE DoorOpeningSystemMonitor__IsDoorOpenedByDOS(void)
{
	return DOS_NV_Data.Door_Opened_By_DOS;
}


/**
 * It sets the status of DOS_NV_Data.Door_Opened_By_DOS.
 *
 * @param  value = the desired value for DOS device (TRUE/FALSE).
 *
 * @return  None
 */
void DoorOpeningSystemMonitor__SetDoorOpenedByDOS(BOOL_TYPE value)
{
	DOS_NV_Data.Door_Opened_By_DOS = value;
}


/**
 * It returns the state of the DOS Push sequence.
 *
 * @return  the status of the DOS Push sequence
 */
DOS_PUSH_STATE_TYPE DoorOpeningSystemMonitor__GetDOSPushState(void)
{
	return DOS_NV_Data.Push_State;
}


/**
 * It sets the status of the DOS Push sequence.
 *
 * @param  value = the desired value for the DOS Push sequence.
 *
 * @return  None
 */
void DoorOpeningSystemMonitor__SetDOSPushState(DOS_PUSH_STATE_TYPE value)
{
	DOS_NV_Data.Push_State = value;
}


/**
 * It returns the state of the DOS Pull sequence.
 *
 * @return  the status of the DOS Pull sequence
 */
DOS_PULL_STATE_TYPE DoorOpeningSystemMonitor__GetDOSPullState(void)
{
	return DOS_NV_Data.Pull_State;
}


/**
 * It sets the status of the DOS Pull sequence.
 *
 * @param  value = the desired value for the DOS Pull sequence.
 *
 * @return  None
 */
void DoorOpeningSystemMonitor__SetDOSPullState(DOS_PULL_STATE_TYPE value)
{
	DOS_NV_Data.Pull_State = value;
}


/**
 * It returns if the DOS Pin is fully retracted.
 *
 * @return  if the DOS Pin is fully retracted.
 * @retval TRUE = the DOS Pin is fully retracted (or DOS feature is not configured in setting file)
 * @retval FALSE = the DOS Pin is not fully retracted (Push or Pull procedure are on going)
 */
BOOL_TYPE DoorOpeningSystemMonitor__IsDOSPinFullyRetracted(void)
{
	BOOL_TYPE ret_value = FALSE;

	if ((DOS_Data.DOS_Pin_State == DOS_PIN_NOT_INIT) || (DOS_Data.DOS_Pin_State == DOS_PIN_FULLY_RETRACTED))
	{
		ret_value = TRUE;
	}

	return ret_value;
}


//=====================================================================================================================
//-------------------------------------- Private Functions ------------------------------------------------------------
//=====================================================================================================================

/**
 * It updates the state of the DOS Pin, based on the state of Push and Pull sequences
 *
 * @return  None
 */
static void UpdateDOSPinState(void)
{
	if (DOS_NV_Data.Pull_State == DOS_PULL_COMPLETE)
	{
		DOS_Data.DOS_Pin_State = DOS_PIN_FULLY_RETRACTED;
	}
	else if (DOS_NV_Data.Pull_State > DOS_PULL_REQUIRED)
	{
		DOS_Data.DOS_Pin_State = DOS_PIN_RETRACTING;
	}
	else
	{
		if (DOS_NV_Data.Push_State == DOS_PUSH_COMPLETE)
		{
			DOS_Data.DOS_Pin_State = DOS_PIN_FULLY_EXTRACTED;
		}
		else
		{
			DOS_Data.DOS_Pin_State = DOS_PIN_EXTRACTING;
		}
	}
}
