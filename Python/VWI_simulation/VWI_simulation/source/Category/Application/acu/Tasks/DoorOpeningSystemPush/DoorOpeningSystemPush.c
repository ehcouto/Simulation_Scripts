/**
 *  @file		DoorOpeningSystemPush.c
 *
 *  @brief		A task that implements the sequence to push out the DOS pin
 *
 *  @details    Door Opening System (briefly DOS) is a device used to assist with the drying by opening the door of the dishwasher
 *  			releasing the moisture out of the tub at selected moment given by the cycle design.
 *  			Door Opening System Push Task shall be activated in the point of the cycle when the DOS pin has to be extracted.
 *  			No Deactivate Task call is needed, the task automatically deactivate itself when it is completed.
 *  			The Push sequence consists of 3 sequential steps, whose duration is specified by setting file parameters:
 *  			- First On: the DOS output is driven on.
 *  			- Off: the DOS output is driven off.
 *  			- Second On: the DOS output is driven on.
 *  			This sequence is processed by the DOS device controller to push out the device pin.
 *
 */

//  --- Include Files -------------------------------------------------------------------------------------------------

// -- This Module --
#include "C_Extensions.h"
#include "DoorOpeningSystemPush.h"

// -- Other Modules --
#include "DoorOpeningSystemMonitor.h"
#include "Log.h"
#include "Hbl.h"
#include "SettingFile.h"


//-------------------------------------- PUBLIC (Variables) -----------------------------------------------------------

//-------------------------------------- PRIVATE (Variables, Constants & Defines) -------------------------------------
//! The name of this module to be used by the Log module.
#define MODULE_NAME MODULE_DOOR_OPENING_SYSTEM_PUSH

//! A list of log message IDs that are generated by this module.
typedef enum MODULE_DOOR_OPENING_SYSTEM_PUSH_LOG_MESSAGE_ID_ENUM
{
	ERROR_MISSING_PARAMETERS  = 1,
} MODULE_DOOR_OPENING_SYSTEM_PUSH_LOG_MESSAGE_ID_TYPE;

//! The number of times that the DoorOpeningSystemPush__Task function will be called every second while running.
#define DOS_PUSH_CALLS_PER_SECOND (uint8)10

typedef struct DOS_PUSH_DATA_STRUCT
{
	uint16 DOS_Push_Counter; //! Timer used to manage the DOS Push procedure
	DOOR_OPENING_SYSTEM_SF_PARAMS_TYPE *SF_DOS_Push_Params_Ptr; //! Pointer to setting file parameters for DOS Push
} DOS_PUSH_DATA_TYPE;

//! Data for DOS Push management
static DOS_PUSH_DATA_TYPE DOS_Push_Data;

//-------------------------------------- PRIVATE (Function Prototypes) ------------------------------------------------


//=====================================================================================================================
//-------------------------------------- Public Functions -------------------------------------------------------------
//=====================================================================================================================

//----------------------------------------------------------------------------
/**
 * It initializes the Door Opening System Push task and its data.
 *
 * @param  compartment = compartment inside which the task is running
 * @param  sf_index = the index of the setting file from which to load the task data
 * @param  displacement = the displacement for the task data in the setting file (unused, since all the instances
 * 		   of the Door Opening System Push Task use the same data table).
 * @return the status of the task (ACTIVE or INACTIVE)
 *
 */
ACTIVE_TYPE DoorOpeningSystemPush__Initialize(uint8 compartment, uint8 sf_index, uint8 displacement)
{
    SETTINGFILE_LOADER_TYPE loader;
	ACTIVE_TYPE ret_value = INACTIVE;

	if (Hbl__GetLoadIndexByLoadID(HBL_LOAD_DOOR_OPENING_SYSTEM) != (uint8)HBL_INDEX_INVALID)
	{
		// Get the DOS Push parameters from the setting file.
		if (SettingFile__BasicLoader(SF_PTR_ACU_ALGORITHM_PARAMETERS, DSPL_DOOR_OPENING_SYSTEM, &loader) == PASS)
		{
			DOS_Push_Data.SF_DOS_Push_Params_Ptr = (DOOR_OPENING_SYSTEM_SF_PARAMS_TYPE *)(void*)loader.Data;

			DoorOpeningSystemPush__StartPush(DOS_Push_Data.SF_DOS_Push_Params_Ptr->Push_Pre_On_Time);
			ret_value = ACTIVE;
		}
		else
		{
			// Algorithm parameters missing, allow step advancement
			LOG_ADD_EXCEPTION(ERROR_MISSING_PARAMETERS, DSPL_DOOR_OPENING_SYSTEM);
		}
	}
	else
	{
		// Door Opening System not present, allow step advancement
	}

	return ret_value;
}


//---------------------------------------------------------------------------------------------------------------------
/**
 * Function called during the execution of the Door Opening System Push task.
 *
 * @param  compartment = compartment inside which the task is running
 * @return the status of the task (ACTIVE or INACTIVE)
 */
ACTIVE_TYPE DoorOpeningSystemPush__Task(uint8 compartment)
{
	ACTIVE_TYPE ret_value = ACTIVE;
	ON_OFF_TYPE dos_pin_state;

	if (DOS_Push_Data.DOS_Push_Counter > (uint16)0)
	{
		DOS_Push_Data.DOS_Push_Counter --;
	}

	switch (DoorOpeningSystemMonitor__GetDOSPushState())
	{
		case DOS_PUSH_PRE_ON_STEP:

			if (DOS_Push_Data.DOS_Push_Counter > (uint16)0)
			{
				dos_pin_state = OFF;
				(void)Hbl__SetLoadRequestByLoadID(HBL_LOAD_DOOR_OPENING_SYSTEM, HBL_PRIORITY_DOOR_OPENING_SYSTEM, (uint8 *) &dos_pin_state);	
				break;
			}
			else
			{
				DOS_Push_Data.DOS_Push_Counter = (uint16)DOS_Push_Data.SF_DOS_Push_Params_Ptr->Push_1st_On_Time * DOS_PUSH_CALLS_PER_SECOND;
				DoorOpeningSystemMonitor__SetDOSPushState(DOS_PUSH_FST_ON_STEP);
			}

		//lint -fallthrough
		case DOS_PUSH_FST_ON_STEP:
			if (DOS_Push_Data.DOS_Push_Counter > (uint16)0)
			{
				dos_pin_state = ON;
				(void)Hbl__SetLoadRequestByLoadID(HBL_LOAD_DOOR_OPENING_SYSTEM, HBL_PRIORITY_DOOR_OPENING_SYSTEM, (uint8 *) &dos_pin_state);	
				break;
			}
			else
			{
				DOS_Push_Data.DOS_Push_Counter = (uint16)DOS_Push_Data.SF_DOS_Push_Params_Ptr->Push_Off_Time * DOS_PUSH_CALLS_PER_SECOND;
				DoorOpeningSystemMonitor__SetDOSPushState(DOS_PUSH_OFF_STEP);
			}

			//lint -fallthrough
		case DOS_PUSH_OFF_STEP:

			if (DOS_Push_Data.DOS_Push_Counter > (uint16)0)
			{
				dos_pin_state = OFF;
				(void)Hbl__SetLoadRequestByLoadID(HBL_LOAD_DOOR_OPENING_SYSTEM, HBL_PRIORITY_DOOR_OPENING_SYSTEM, (uint8 *) &dos_pin_state);	
				break;
			}
			else
			{
				DOS_Push_Data.DOS_Push_Counter = (uint16)DOS_Push_Data.SF_DOS_Push_Params_Ptr->Push_2nd_On_Time * DOS_PUSH_CALLS_PER_SECOND;
				DoorOpeningSystemMonitor__SetDOSPushState(DOS_PUSH_SND_ON_STEP);
			}

			//lint -fallthrough
		case DOS_PUSH_SND_ON_STEP:
			if (DOS_Push_Data.DOS_Push_Counter > (uint16)0)
			{
				dos_pin_state = ON;
				(void)Hbl__SetLoadRequestByLoadID(HBL_LOAD_DOOR_OPENING_SYSTEM, HBL_PRIORITY_DOOR_OPENING_SYSTEM, (uint8 *) &dos_pin_state);	
			}
			else
			{
				DoorOpeningSystemMonitor__SetDOSPushState(DOS_PUSH_COMPLETE);

				ret_value = INACTIVE;
			}
			break;

		default:
			// Includes DOS_PUSH_COMPLETE
			ret_value = INACTIVE;
			break;
	}

	return ret_value;
}


/**
 * It is called at the initialization of the task after NVdata restore.
 * If it founds that the task was running before the reset, it restarts it.
 *
 * @param  compartment = compartment inside which the task is running
 *
 * @return  None
 */
void DoorOpeningSystemPush__NVDataRestore(uint8 compartment)
{
	if (DoorOpeningSystemMonitor__GetDOSPushState() != DOS_PUSH_COMPLETE)
	{
	    SETTINGFILE_LOADER_TYPE loader;

		// If Push procedure has been interrupted by a cold reset it has to be restarted

		// Get the DOS Push parameters from the setting file.
		if (SettingFile__BasicLoader(SF_PTR_ACU_ALGORITHM_PARAMETERS, DSPL_DOOR_OPENING_SYSTEM, &loader) == PASS)
		{
			DOS_Push_Data.SF_DOS_Push_Params_Ptr = (DOOR_OPENING_SYSTEM_SF_PARAMS_TYPE *)(void*)loader.Data; 

			DoorOpeningSystemPush__StartPush(DOS_Push_Data.SF_DOS_Push_Params_Ptr->Push_Pre_On_Time);
		}
		else
		{
			// Algorithm parameters missing, allow step advancement
			LOG_ADD_EXCEPTION(ERROR_MISSING_PARAMETERS, DSPL_DOOR_OPENING_SYSTEM);
			DoorOpeningSystemMonitor__SetDOSPushState(DOS_PUSH_COMPLETE);
		}

	}
}


/**
 * It is called when the task ends
 *
 * @param  compartment = compartment inside which the task is running
 *
 * @return  None
 */
void DoorOpeningSystemPush__Terminate(uint8 compartment)
{

}


/**
 * It sets up the Door Opening System task push data to start the DOS Push sequence.
 *
 * @param  time = the duration of the first step of the Push sequence (in 1/10 seconds)
 *
 * @return  None
 */
void DoorOpeningSystemPush__StartPush(uint8 time)
{
	DoorOpeningSystemMonitor__SetDoorOpenedByDOS(TRUE);
	DoorOpeningSystemMonitor__SetDOSPullState(DOS_PULL_REQUIRED);
	DoorOpeningSystemMonitor__SetDOSPushState(DOS_PUSH_PRE_ON_STEP);
	DOS_Push_Data.DOS_Push_Counter = (uint16)time + (uint8)1; // the +1 is to account for the first decrement inside DoorOpeningSystemPush__Task
}


//=====================================================================================================================
//-------------------------------------- Private Functions ------------------------------------------------------------
//=====================================================================================================================

