/**
 * @file
 * @brief       Manages delays between detection of abnormal conditions and generation of pre-faults and faults.
 *
 * @details
 *
 * The Fault module runs multiple parallel state machines. One for each actively detected error
 * condition. If there are more actively detected error conditions than there are Fault state
 * machines, then the available state machines only manage the highest priority error conditions.
 *
    @startuml{fault_sm.jpg}
        title Fault Observer State Machine
        ' use state = Fault_Nv.Observers[Fault.Instance].State

        [*] --> Alarm

        ' Alarm State:
        ' System has detected an error condition.
        ' No reaction has been taken.
        ' System is debouncing the error condition to determine if any pre-fault reaction is necessary.
        Alarm : entry / SetupAlarmDebounce()\n\t CheckForNoDebounce()
        Alarm : do / DebounceError()
        Alarm --> Pre_Fault : Debounce(FAULT_DEBOUNCE_EVENT_NEXT)\n/ SetupPreFaultDebounce()
        Alarm --> Fault : Debounce(FAULT_DEBOUNCE_EVENT_NEXT)\n[DirectToFault()]
        Alarm --> [*] : Debounce(FAULT_DEBOUNCE_EVENT_CANCEL)

        ' Pre_Fault State:
        ' System has debounced an error condition and the pre-fault reactions must be taken.
        ' System is debouncing the error condition further to determine if any fault reaction is necessary.
        Pre_Fault : entry / CheckForNoDebounce()\n\t TriggerPreFaultReaction()
        Pre_Fault : do / DebounceError()
        Pre_Fault --> Pre_Fault : Debounce(FAULT_DEBOUNCE_EVENT_REPEAT)
        Pre_Fault --> Fault : Debounce(FAULT_DEBOUNCE_EVENT_NEXT)
        Pre_Fault --> [*] : Debounce(FAULT_DEBOUNCE_EVENT_CANCEL)

        ' Fault State:
        ' System has debounced an error condition and the fault reactions must be taken.
        ' The Fault module is remembering a fault (if necessary) across a cold reset.
        ' The Fault module is preventing the Supervisor from exiting the Fault state (if necessary).
        ' The Fault module is blocking the System's ability to detect the same fault again.
        Fault : entry / TriggerFaultReaction()
        Fault : do / DebounceErrorRemoval()
        Fault --> [*] : Debounce(FAULT_DEBOUNCE_EVENT_CANCEL)

        "Supervisor Interactions": 1. If the Supervisor is in the Supervisor Fault state, then\n\t the fault observer will not leave the Fault state.\n2. When the Supervisor enters the Supervisor Programming\n\t state, all fault observers in the Fault state (for that\n\t compartment) are terminated.
    @enduml
 *
 * The external events in the state machine are generated by a Debounce Method. The Debounce
 * Methods are managed by external modules. There are two primary Debounce Methods:
 *      - FdmCounter counts error detection events to determine when to raise events.
 *      - FdmTimer counts time that an error condition is present or absent to determine when to
 *                  raise events.
 *
 *
 * The Fault module's setting file data is arranged such that the highest priority faults are
 * stored first and faults that are disabled (or deprecated) are not stored at all. The start of
 * each fault's setting file data starts with the following structure:
 *
 *      Start of Data For All Enabled Faults:
 *              |  7 |  6 |  5 |  4 |  3 |  2 |  1 |  0 |  7 |  6 |  5 |  4 |  3 |  2 |  1 |  0 |
 *      +0000h  |                Fault_ID               |      Debounce_Method_Displacement     |
 *      +0001h  |              Compartment              |      Sub_Code     |        Code       |
 *      +0002h  | ACR| CCR| PC | D2F|  Engineering_Code |               Sub-Cycle               |
 *      =0003h  |                 Phase                 |         <Fault-Specific Data>         |
 *
 *          Fault_ID = The ID of the category-specific fault. Refer to Fault_prm.h for specific
 *                      codes.
 *          Debounce_Method_Displacement = The displacement that references the debounce method
 *                      used to transition from Alarm to pre-fault and from pre-fault to fault.
 *              0xFF = Use the default debounce method. Uses single detection event transitions.
 *          Code = A value that describes a group of faults.
 *          Sub_Code = A value that differentiates multiple faults with the same Code. The Code and
 *                      Sub_Code combination identifies a unique serviceable fault.
 *          Engineering_Code = A value that differentiates multiple faults with the same Code and
 *                      Sub_Code. The Code, Sub_Code, and Engineering_Code combination identifies a
 *                      unique fault that may be of interest to Engineering.
 *          D2F (Direct_To_Fault) = Determines whether the Fault ID will ever generate a pre-fault.
 *              0 = Generate a pre-fault when the error condition is debounced.
 *              1 = Generate a fault when the error condition is debounced.
 *          PC (Pause_Cycle) = Determines whether the pre-fault will pause the main cycle.
 *              0 = Do not pause the main cycle when the pre-fault is triggered.
 *              1 = Pause the main cycle when the pre-fault is triggered.
 *          ACR (Allow Clear without Removing the fault)
 *              0 = The error condition needs to be removed before the Supervisor can exit the
 *                  Supervisor Fault state.
 *              1 = The error condition does not need to be removed before the Supervisor can exit
 *                  the Supervisor Fault state.
 *          CCR (Clear the fault after a Cold Reset)
 *              0 = The fault management is not affected by a cold reset.
 *              1 = The fault management is reset if a cold reset occurs.
 *          Phase = The Supervisor runs this phase (macro) of the Fault Cycle when the fault occurs.
 *          Sub_Cycle = The specified sub-cycle is requested when the pre-fault occurs.
 *              0xFF = Do not request any sub-cycle when the pre-fault occurs.
 *
 * Each fault can have additional parameters that are stored after the basic structure.
 *
 *
 * Each fault has a debounce method whose behavior is described by the Debounce_Method_Displacement.
 * The debounce method parameters are described in the following structure:
 *
 *      Debounce_Method_Displacement Data:
 *              |  7 |  6 |  5 |  4 |  3 |  2 |  1 |  0 |  7 |  6 |  5 |  4 |  3 |  2 |  1 |  0 |
 *      +0000h  |    0    |   PDM   |  0 |  Detect PPS  |         Detect Pre_Fault_Delay        |
 *      +0001h  |    0    |   FDM   |  0 |  Detect FPS  |           Detect Fault_Delay          |
 *      +0002h  |            0           |  Remove PPS  |         Remove Pre_Fault_Delay        | (Optional)
 *      +0003h  |            0           |  Remove FPS  |           Remove Fault_Delay          | (Optional)
 *
 *          PDM (Pre_Fault_Debounce_Method) = The method used to debounce an error condition into
 *                      a pre-fault condition.
 *              0 = Use time-based debouncing of the error condition
 *              1 = Use event-based debouncing of the error condition
 *          PPS (Pre_Fault_Prescalar) = The scale used to interpret the Pre_Fault_Delay field.
 *              0 = 1 count in the Delay field corresponds to 100 milliseconds.
 *              1 = 1 count in the Delay field corresponds to 1 second.
 *              2 = 1 count in the Delay field corresponds to 10 seconds.
 *              3 = 1 count in the Delay field corresponds to 1 minute.
 *              4 = 1 count in the Delay field corresponds to 10 minutes.
 *          Pre_Fault_Delay = A time or a count used to debounce the error condition into a pre-
 *                      fault condition.
 *          FDM (Fault_Debounce_Method) = The method used to debounce a pre-fault condition into a
 *                      fault condition.
 *              0 = Use time-based debouncing of the pre-fault condition
 *              1 = Use event-based debouncing of the pre-fault condition
 *          FPS (Fault_Prescalar) = The scale used to interpret the Fault_Delay field.
 *              0 = 1 count in the Delay field corresponds to 100 milliseconds.
 *              1 = 1 count in the Delay field corresponds to 1 second.
 *              2 = 1 count in the Delay field corresponds to 10 seconds.
 *              3 = 1 count in the Delay field corresponds to 1 minute.
 *              4 = 1 count in the Delay field corresponds to 10 minutes.
 *          Fault_Delay = A time or a count used to debounce the pre-fault condition into a fault
 *                      condition.
 *
 *
 * @copyright  Copyright 2016-2018 Whirlpool Corporation.  All rights reserved - CONFIDENTIAL.
 */

//  --- Include Files -------------------------------------------------------------------------------------------------

// -- This Module --
#include "SystemConfig.h"
#include "Fault.h"
#include "Fault_prv.h"

// -- Other Modules --
#if (API018_SERVER_FEATURE == ENABLED)
    #include "API018Diagnostic.h"
#endif
#include "Callback.h"
#include "FdmCounter.h"
#include "FdmTimer.h"
#include <limits.h>
#include "Log.h"
#include "Micro.h"
#include "NVData.h"
#include "SettingFile.h"
#include "Statistics.h"
#include <string.h>


#ifndef MAX_PARALLEL_FAULT_OBSERVERS
    #ifdef MAX_PARALLEL_FAULT_MONITORS
        #define MAX_PARALLEL_FAULT_OBSERVERS MAX_PARALLEL_FAULT_MONITORS
    #else
        #define MAX_PARALLEL_FAULT_OBSERVERS 1
    #endif
#endif

// There must be at least one state machine to manage faults.
// If you want to disable the Faults for debugging, then disable them through the setting file.
CT_ASSERT(MAX_PARALLEL_FAULT_OBSERVERS > 0);


//=====================================================================================================================
//=== StateEngineCrank (v2.8) Auto-Generated Definitions for Fault Observer State Machine
//=====================================================================================================================
// !! StateEngineCrank cannot update this code if you change the header !!


//! Unique names used to identify states of the Fault Observer state machine.
typedef enum FAULT_OBSERVER_STATE_ENUM
{
    STATE_FAULT_OBSERVER_NONE                    = 0,

    STATE_FAULT_OBSERVER_ALARM                   = 1, //!< (initial_state)
    STATE_FAULT_OBSERVER_PRE_FAULT               = 2,
    STATE_FAULT_OBSERVER_FAULT                   = 3,
    STATE_FAULT_OBSERVER_SUPERVISOR_INTERACTIONS = 4,

    STATE_FAULT_OBSERVER_END                     = 5
} FAULT_OBSERVER_STATE_TYPE;

//! The transition variable for the Fault Observer state machine.
//! Flag used by the state machine to track when a transition occurs in the middle of a state's
//! Entry() or Do() action that contains more than one function.
static BOOL_TYPE Fault_Observer_Transitioned;

// -- Private Function Prototypes used by the state machine for customization functions --
static void CheckForNoDebounce(void);
static void DebounceError(void);
static void DebounceErrorRemoval(void);
static BOOL_TYPE DirectToFault(void);
static void SetupAlarmDebounce(void);
static void SetupPreFaultDebounce(void);
static void TriggerFaultReaction(void);
static void TriggerPreFaultReaction(void);

// -- Private Function Prototypes used by the state machine for standard state machine functions --
static void ExternalEventDebounce(uint8 event);
static void FaultObserverExecute(void);
static void FaultObserverInitialize(void);
static void FaultObserverTerminate(void);

// !! StateEngineCrank cannot update this code if you change the footer !!
// End of StateEngineCrank Auto-Generated Code.


//  --- Private Properties --------------------------------------------------------------------------------------------


// -- Private Constant Declarations --

//! The name of this module for use by the Log module.
#define MODULE_NAME                     MODULE_FAULT

//! The displacement that contains the sorted list of configured fault IDs.
#define SF_DISPL_SORTED_FAULT_ID_LIST   5


// -- Private Enumeration Type Declarations --

//! A list of log message IDs that are generated by this module.
typedef enum MODULE_FAULT_LOG_MESSAGE_ID_ENUM
{
    IGNORED_DEFINED_FAULT,
    REQUESTED_MISSING_FAULT_INFO,
    SF_MISSING_SPECIFIC_DATA_FAULT_DATA,
    MISSING_SORTED_FAULT_LIST
} MODULE_FAULT_LOG_MESSAGE_ID_TYPE;


// -- Private Structure Type Declarations --

//! The nonvolatile data associated with a single observed fault.
typedef struct FAULT_OBSERVER_STRUCT
{
    FAULT_DEBOUNCE_PROPERTIES_TYPE Fdm;
    uint8 Priority;
    FAULT_OBSERVER_STATE_TYPE State : 7;
    uint8 Is_Condition_Removed      : 1;
} FAULT_OBSERVER_TYPE;

//! A structure with all the nonvolatile data used by the Fault module.
typedef struct FAULT_NV_DATA_STRUCT
{
    //! Whether or not faults are accelerated.
    BOOL_TYPE Accelerate_Faults;

    //! The nonvolatile variables associated with each of the faults.
    FAULT_OBSERVER_TYPE Observers[MAX_PARALLEL_FAULT_OBSERVERS];
} FAULT_NV_DATA_TYPE;

//! A structure with all the (volatile) data used by the Fault module.
typedef struct FAULT_DATA_STRUCT
{
    //! The list of all configured faults sorted by priority.
    FAULT_LIST_TYPE* List;

    //! The fault configuration data for each fault observer.
    FAULT_CONFIG_TYPE* Config[MAX_PARALLEL_FAULT_OBSERVERS];

    //! The fault debounce configuration for each fault observer.
    FAULT_DEBOUNCE_TYPE* Debounce[MAX_PARALLEL_FAULT_OBSERVERS];

    //! The faults being managed by the Supervisor in each compartment.
    //! Bit N represents compartment N.
    //!     0 = Supervisor is not managing any fault.
    //!     1 = Supervisor is managing a fault.
    #if (APPLIANCE_MAX_COMPARTMENTS <= 8)
        uint8 Managed_Compartments;
    #elif (APPLIANCE_MAX_COMPATMENTS <= 16)
        uint16 Managed_Compartments;
    #endif

    //! The instance of the state machine that is running.
    uint8 Instance;

    //! Flag that indicates that all fault observers should be reset.
    //! Used to synchronize clearing the faults with the AppMgr thread.
    BOOL_TYPE Reset_All_Observers;
} FAULT_DATA_TYPE;


// -- Private Flash-Based Constant Definitions --

//! References to all debounce methods.
static const FAULT_DEBOUNCE_HOOK_TYPE DEBOUNCE_METHODS[] =
{
    FDM_TIMER_REGISTER,
    FDM_COUNTER_REGISTER
};

//! Default debounce parameters to use when none are provided in the setting file.
//! By default, it will use 10 second timed delays for the debounce.
static const FAULT_DEBOUNCE_TYPE FAULT_DEFAULT_DEBOUNCE_CONFIG[] =
{
    // Prescalar,    Unused,    Debounce Method,    Unused,    Delay
    {      0,           0,             0,              0,       100     },
    {      0,           0,             0,              0,       100     },
    {      0,           0,             0,              0,       100     },
    {      0,           0,             0,              0,       100     }
};


// -- Private Variable Definitions --

#if (MAX_FAULT_HANDLERS > 0)
//! Define fault reporting callback control registry.
DEFINE_CALLBACK_CONTROL_STRUCTURE(Callback_Control_Fault, MAX_FAULT_HANDLERS);
#endif      // #if (MAX_FAULT_HANDLERS > 0)

#if (MAX_PRE_FAULT_HANDLERS > 0)
//! Define pre-fault reporting callback control registry.
DEFINE_CALLBACK_CONTROL_STRUCTURE(Callback_Control_Pre_Fault, MAX_PRE_FAULT_HANDLERS);
#endif      // #if (MAX_PRE_FAULT_HANDLERS > 0)

//! Define all static (volatile) data used by the Fault module.
static FAULT_DATA_TYPE Fault;

//! The highest priority active fault in each compartment.
FAULT_ID_TYPE Fault_Id[APPLIANCE_MAX_COMPARTMENTS];

#pragma location = "_appliance_segment"
//! Define all static nonvolatile data used by the Fault module.
static FAULT_NV_DATA_TYPE Fault_Nv;

//! The highest priority active pre-fault in each compartment.
FAULT_ID_TYPE Prefault_Id[APPLIANCE_MAX_COMPARTMENTS];


// -- Private Macro Declarations --

#ifndef RESET_FAULT_DETECTORS
    //! Macro used to synchronize the reset of fault detection firmware internal variables with the
    //! reset of the faults in the Fault module.
    //!
    //! Alternatives to consider:
    //!     1) The fault detection firmware can immediately detect the fault again since the fault
    //!         is still present. This may be the desired behavior.
    //!     2) The fault detection firmware can use Fault__IsObserverActive() or
    //!         Fault__IsInFaultState() to detect that the observer is reset through polling.
    #define RESET_FAULT_DETECTORS()
#endif


//  --- Private Function Prototypes -----------------------------------------------------------------------------------

static void ExecuteFaultDebounceMethod(FAULT_DEBOUNCE_FUNCTION_ID_TYPE function_id);
static uint8 FindExistingObserver(FAULT_ID_TYPE fault_id);
static uint8 GetActiveFaultObserver(uint8 compartment);
static uint8 GetActivePreFaultObserver(uint8 compartment);
static FAULT_CONFIG_TYPE* FindConfigParameters(FAULT_ID_TYPE fault_id, uint8* priority);
static FAULT_CONFIG_TYPE* GetConfigParameters(uint8 priority);
static FAULT_DEBOUNCE_TYPE* GetDebounceParameters(uint8 debounce_method_displ);
static void RestoreSfReferences(void);
static void UpdateFaultIDs(void);


//=====================================================================================================================
//  --- Public Methods ------------------------------------------------------------------------------------------------
//=====================================================================================================================


//---------------------------------------------------------------------------------------------------------------------
/**
 * Initialize the Fault module variables.
 */
void Fault__Initialize(void)
{
    BOOL_TYPE nvdata_corrupted = (BOOL_TYPE)(NVData__GetLastRestoreStatus()->Bit.Appliance_Data_Recovered != NVDATA_RESTORE_OKAY);
    if (Micro__GetResetMode() == MICRO_RESET_MODE_COLD)
    {
        if (nvdata_corrupted == TRUE)
        {
            // Nonvolatile data was lost -- reset all state machines.
            memset(&Fault_Nv, 0, sizeof(Fault_Nv));
        }
        #if (MAX_FAULT_HANDLERS > 0)
            Callback__Initialize(&Callback_Control_Fault);
        #endif
        #if (MAX_PRE_FAULT_HANDLERS > 0)
            Callback__Initialize(&Callback_Control_Pre_Fault);
        #endif
    }

    // Reset and rebuild all volatile data.
    memset(Prefault_Id, FAULT_ID_NONE, sizeof(Prefault_Id));
    memset(Fault_Id, FAULT_ID_NONE, sizeof(Fault_Id));
    memset(&Fault, 0, sizeof(Fault));
    RestoreSfReferences();

    // On a normal cold reset, terminate any state machines with the CCR bit set.
    if ((Micro__GetResetMode() == MICRO_RESET_MODE_COLD) &&
        (nvdata_corrupted == FALSE))
    {
        for (Fault.Instance = 0; Fault.Instance < MAX_PARALLEL_FAULT_OBSERVERS; Fault.Instance++)
        {
            if ((Fault_Nv.Observers[Fault.Instance].State != STATE_FAULT_OBSERVER_NONE) &&
                ((Fault.Config[Fault.Instance] == NULL) ||
                 (Fault.Config[Fault.Instance]->Clear_On_Cold_Reset == TRUE)))
            {
                Fault_Nv.Observers[Fault.Instance].State = STATE_FAULT_OBSERVER_NONE;
            }
            if (Fault.Debounce[Fault.Instance] == NULL)
            {
                Fault.Debounce[Fault.Instance] = (void*)FAULT_DEFAULT_DEBOUNCE_CONFIG;
            }
        }
    }
    UpdateFaultIDs();
}


//---------------------------------------------------------------------------------------------------------------------
/**
 * Background function for the Fault module.
 */
void Fault__Background(void)
{
    if (Fault.Reset_All_Observers == TRUE)
    {
        // Faults were cleared so remove all active faults.
        for (uint8 instance = 0; instance < MAX_PARALLEL_FAULT_OBSERVERS; instance++)
        {
            Fault_Nv.Observers[instance].State = STATE_FAULT_OBSERVER_NONE;
        }
        RESET_FAULT_DETECTORS();
        Fault.Reset_All_Observers = FALSE;
    }
    for (Fault.Instance = 0; Fault.Instance < MAX_PARALLEL_FAULT_OBSERVERS; Fault.Instance++)
    {
        // Execute all the fault observer state machines.
        FaultObserverExecute();
    }
    UpdateFaultIDs();
}


//---------------------------------------------------------------------------------------------------------------------
/**
 * Inform the Fault module that the compartment is managing the fault.
 * This is a vague concept for this module to understand that the high-level system is taking
 * some action in response to the fault. Specifically, the Supervisor is in the FAULT state.
 * @param compartment = The compartment that is managing the fault.
 */
void Fault__CompartmentManaged(uint8 compartment)
{
    if (compartment < APPLIANCE_MAX_COMPARTMENTS)
    {
        BIT_SET(Fault.Managed_Compartments, compartment);
    }
}


//---------------------------------------------------------------------------------------------------------------------
/**
 * Terminate fault observers for all faults that are active in the specified compartment.
 * @param compartment = The compartment in which the active faults should be reset.
 * @return Always returns TRUE.
 */
BOOL_TYPE Fault__CompartmentReset(uint8 compartment)
{
    if (compartment < APPLIANCE_MAX_COMPARTMENTS)
    {
        // Clear all fault observer state machines in the specified compartment.
        for (uint8 observer = 0; observer < MAX_PARALLEL_FAULT_OBSERVERS; observer++)
        {
            if ((Fault_Nv.Observers[observer].State == STATE_FAULT_OBSERVER_FAULT) &&
                (Fault.Config[observer]->Compartment == compartment))
            {
                Fault_Nv.Observers[observer].State = STATE_FAULT_OBSERVER_NONE;
            }
        }

        // Remove active pre-fault and fault information.
        BIT_CLR(Fault.Managed_Compartments, compartment);
        Prefault_Id[compartment] = FAULT_ID_NONE;
        Fault_Id[compartment] = FAULT_ID_NONE;
    }
    return TRUE;
}


//---------------------------------------------------------------------------------------------------------------------
/**
 * Request that the Fault module start observing (or continue observing) the specified fault.
 *
 * For pre-faults and faults whose debouncing is time-based, only one call to this function is
 * required to start the timers.
 *
 * For pre-faults and faults whose debouncing is event-based, this function must be called each
 * time the error condition is detected.
 *
 * @param fault_id = The ID of the fault to observe.
 */
void Fault__ConditionDetected(FAULT_ID_TYPE fault_id)
{
    // Get the instance of the existing observer for the specified fault_id (if there is one).
    uint8 observer = FindExistingObserver(fault_id);
    if (observer < MAX_PARALLEL_FAULT_OBSERVERS)
    {
        // The fault is already being observed.
        Fault.Instance = observer;
        Fault_Nv.Observers[Fault.Instance].Is_Condition_Removed = FALSE;
        ExecuteFaultDebounceMethod(FDM_CONDITION_DETECTED);
    }
    else
    {
        // The fault is not yet being observed.
        uint8 this_fault_priority;
        FAULT_CONFIG_TYPE* config = FindConfigParameters(fault_id, &this_fault_priority);
        if (config != NULL)
        {
            // Look for the first unused fault observer.
            uint8 lowest_priority_found = 0;
            for (uint8 observer_candidate = 0; observer_candidate < MAX_PARALLEL_FAULT_OBSERVERS; observer_candidate++)
            {
                if (Fault_Nv.Observers[observer_candidate].State == STATE_FAULT_OBSERVER_NONE)
                {
                    // Use the first unused fault observer.
                    observer = observer_candidate;
                    break;                          // Break out of for() loop.
                }
                else
                {
                    // Check if this lowest priority fault can be terminated and replaced with this fault (due to priorities).
                    // Remember: Lower priority values represent higher priority.
                    uint8 a_fault_priority = Fault_Nv.Observers[observer_candidate].Priority;
                    // Check if...
                    //  1) The iterated fault's priority is lower than this fault's priority, and...
                    //  2) The iterated fault's priority is lower than the lowest priority found so far.
                    if ((this_fault_priority   < a_fault_priority) &&
                        (lowest_priority_found < a_fault_priority))
                    {
                        // Update the lowest priority found so far.
                        lowest_priority_found = a_fault_priority;
                        // Remember the observer with the lowest priority fault found so far.
                        // Continue looking for an even lower priority fault.
                        observer = observer_candidate;
                    }
                }
            }

            // Check if a valid fault observer was found for the detected fault.
            if (observer < MAX_PARALLEL_FAULT_OBSERVERS)
            {
                // Setup the fault observer data for the specified fault.
                Fault.Instance = observer;
                Fault.Config[Fault.Instance] = config;
                Fault_Nv.Observers[Fault.Instance].Priority = this_fault_priority;
                Fault_Nv.Observers[Fault.Instance].Is_Condition_Removed = FALSE;

                // Initialize the associated Fault state machine.
                FaultObserverInitialize();
            }
            else
            {
                // A fault was ignored because there are not enough parallel fault observers.
                // To avoid this, increase the value of MAX_PARALLEL_FAULT_OBSERVERS.
                LOG_ADD_EXCEPTION(IGNORED_DEFINED_FAULT, fault_id);
            }
        }
        else
        {
            // A fault was ignored because it is not defined in the setting file.
            // To avoid this, add configuration data for the fault in the setting file.

            // Several platforms are detecting conditions regardless of whether the fault is
            // enabled or disbled. Therefore, we don't want to generate an exception as it will
            // flood the exception queue.
        }
    }
}


//---------------------------------------------------------------------------------------------------------------------
/**
 * Inform the Fault module that the error condition is now absent.
 *
 * This call allows the Supervisor to exit the fault state if it wishes to in the future.
 *
 * If the fault observer is not yet in the fault state, or if the Supervisor fault macro is not
 * defined, then this call will be passed to the Debounce Method which may terminate the fault
 * observer state machine.
 *
 * @param fault_id = The ID of the fault being observed.
 */
void Fault__ConditionRemoved(FAULT_ID_TYPE fault_id)
{
    uint8 observer = FindExistingObserver(fault_id);
    if (observer < MAX_PARALLEL_FAULT_OBSERVERS)
    {
        Fault_Nv.Observers[observer].Is_Condition_Removed = TRUE;
        if ((Fault_Nv.Observers[observer].State != STATE_FAULT_OBSERVER_FAULT) ||
            (Fault.Config[observer]->Phase == SF_DISPL_INVALID_VALUE))
        {
            Fault.Instance = observer;
            if (Fault_Nv.Accelerate_Faults == TRUE)
            {
                FaultObserverTerminate();
            }
            else
            {
                ExecuteFaultDebounceMethod(FDM_CONDITION_REMOVED);
            }
        }
    }
}


//---------------------------------------------------------------------------------------------------------------------
/**
 * Get the number of faults configured in the setting file.
 * @return The number of faults configured in the setting file.
 *         NULL if the application is using an old setting file.
 */
FAULT_LIST_TYPE* Fault__GetConfiguredFaults(void)
{
    return Fault.List;
}


//---------------------------------------------------------------------------------------------------------------------
/**
 * Get the information associated with a specific fault observer.
 * @param observer = The index of the fault observer.
 * @param info = A pointer to a structure to fill with the fault information.
 */
void Fault__GetEventInfo(uint8 observer, FAULT_CONFIG_TYPE** info)
{
    if ((observer < MAX_PARALLEL_FAULT_OBSERVERS) &&
        (Fault_Nv.Observers[observer].State != STATE_FAULT_OBSERVER_NONE))
    {
        *info = Fault.Config[observer];
    }
    else
    {
        *info = NULL;
        LOG_ADD_EXCEPTION(REQUESTED_MISSING_FAULT_INFO, observer);
    }
}


//---------------------------------------------------------------------------------------------------------------------
/**
 * Get the setting file fault parameters for the specified fault.
 * @param fault_id = The fault ID used to search the setting file for fault parameters.
 * @return A pointer to the setting file data structure with the fault parameters.
 *         If a failure occurs, returns NULL.
 */
FAULT_CONFIG_TYPE* Fault__GetParameters(FAULT_ID_TYPE fault_id)
{
    uint8 priority;
    return FindConfigParameters(fault_id, &priority);
}


//---------------------------------------------------------------------------------------------------------------------
/**
 * Get the remaining time for the specified fault.
 * @param fault_id = The fault ID used to retrieve the fault data.
 * @return Remaining time in 100ms increments
 */
uint32 Fault__GetRemainingTime(FAULT_ID_TYPE fault_id)
{
    uint32 remaining_time = 0;
    uint8 observer = FindExistingObserver(fault_id);

    if ((observer < MAX_PARALLEL_FAULT_OBSERVERS) &&
        ((Fault_Nv.Observers[observer].State != STATE_FAULT_OBSERVER_FAULT) ||
         (Fault.Config[observer]->Phase == SF_DISPL_INVALID_VALUE)))
    {
        remaining_time = Fault_Nv.Observers[observer].Fdm.Timer.Time;
    }

    return(remaining_time);
}


//---------------------------------------------------------------------------------------------------------------------
/**
 * Get the setting file fault additional data for the specified fault.
 * @param fault_id = The fault ID used to search the setting file for fault specific data.
 * @return A pointer to the setting file data structure with the fault specific data.
 *          If a failure occurs, returns NULL.
 */
void* Fault__GetSpecificData(FAULT_ID_TYPE fault_id)
{
    void* fault_data = NULL;
    uint8 priority;
    FAULT_CONFIG_TYPE* config = FindConfigParameters(fault_id, &priority);
    if ((config != NULL) && (config->Fault_Specific_Displacement != UCHAR_MAX))
    {
        SETTINGFILE_LOADER_TYPE loader;
        if (SettingFile__BasicLoader(SF_PTR_ACU_FAULT_DATA, config->Fault_Specific_Displacement, &loader) == PASS)
        {
            fault_data = (void*)(loader.Data);
        }
        else
        {
            LOG_ADD_EXCEPTION(SF_MISSING_SPECIFIC_DATA_FAULT_DATA, fault_id);
        }
    }
    return fault_data;
}


//---------------------------------------------------------------------------------------------------------------------
/**
 * Get the state of a fault
 * @param fault_id = The fault ID used to retrieve the fault data.
 * @return State of the requested fault
 *         Returns FAULT_STATE_NONE if the fault is not being observed
 */
FAULT_STATE_TYPE Fault__GetState(FAULT_ID_TYPE fault_id)
{
    FAULT_STATE_TYPE fault_state = FAULT_STATE_NONE;
    uint8 observer = FindExistingObserver(fault_id);

    if (observer < MAX_PARALLEL_FAULT_OBSERVERS)
    {
        switch(Fault_Nv.Observers[observer].State)
        {
            case STATE_FAULT_OBSERVER_ALARM:
                fault_state = FAULT_STATE_ALARM;
                break;
            case STATE_FAULT_OBSERVER_PRE_FAULT:
                fault_state = FAULT_STATE_PRE_FAULT;
                break;
            case STATE_FAULT_OBSERVER_FAULT:
                fault_state = FAULT_STATE_FAULT;
                break;
            case STATE_FAULT_OBSERVER_NONE:
            default:
                fault_state = FAULT_STATE_NONE;
                break;
        }
    }

    return(fault_state);
}


//---------------------------------------------------------------------------------------------------------------------
/**
 * Determine if a fault observer for the specified fault_id is in the Fault state.
 * @param fault_id = The fault ID used to search the setting file for fault specific data.
 * @return TRUE if any observer is handling the specified fault_id and is in the Fault state.
 */
BOOL_TYPE Fault__IsInFaultState(FAULT_ID_TYPE fault_id)
{
    uint8 observer = FindExistingObserver(fault_id);
    if (observer < MAX_PARALLEL_FAULT_OBSERVERS)
    {
        return (BOOL_TYPE)(Fault_Nv.Observers[observer].State == STATE_FAULT_OBSERVER_FAULT);
    }
    return FALSE;
}


//---------------------------------------------------------------------------------------------------------------------
/**
 * Determine if a fault observer for the specified fault_id is active.
 * @param fault_id = The fault ID used to search the setting file for fault specific data.
 * @return TRUE if any observer that is actively handling the specified fault_id.
 */
BOOL_TYPE Fault__IsObserverActive(FAULT_ID_TYPE fault_id)
{
    uint8 observer = FindExistingObserver(fault_id);
    return ((observer < MAX_PARALLEL_FAULT_OBSERVERS) ? TRUE : FALSE);
}


//---------------------------------------------------------------------------------------------------------------------
/**
 * Determine if it is ok for the Supervisor to exit the Fault state.
 * It is ok for the Supervisor to exit the fault state if all fault observers in the compartment
 * can be cleared. A fault observer can be cleared if at least one of the following conditions is
 * satisfied:
 *      - The fault observer is in the ALARM or PREFAULT state.
 *      - The error condition for the fault has been removed.
 *      - The fault configuration allows the fault to be cleared without removing the error condition.
 * @param compartment = The compartment in which the active fault should be reset.
 * @return TRUE if it is ok for the Supervisor to exit the Fault state.
 */
BOOL_TYPE Fault__IsOkToExitFaultState(uint8 compartment)
{
    for (uint8 observer = 0; observer < MAX_PARALLEL_FAULT_OBSERVERS; observer++)
    {
        if ((Fault_Nv.Observers[observer].State == STATE_FAULT_OBSERVER_FAULT) &&
			(Fault.Config[observer]->Compartment == compartment) &&
            (Fault.Config[observer]->Allow_Clear_Without_Remove == FALSE) &&
            (Fault_Nv.Observers[observer].Is_Condition_Removed == FALSE))
        {
            return FALSE;
        }
    }
    return TRUE;
}


//---------------------------------------------------------------------------------------------------------------------
/**
 * Register a function handler to be called when any fault occurs.
 * @param fault_handler_function = Pointer to the fault event handler function.
 */
void Fault__RegisterFaultEvents(FAULT_EVENT_HANDLER_TYPE fault_handler_function)
{
    #if (MAX_FAULT_HANDLERS > 0)
        Callback__Register(&Callback_Control_Fault, fault_handler_function);
    #endif
}


//---------------------------------------------------------------------------------------------------------------------
/**
 * Register a function handler to be called when any pre-fault occurs.
 * @param pre_fault_handler_function = Pointer to the pre-fault event handler function.
 */
void Fault__RegisterPreFaultEvents(PRE_FAULT_EVENT_HANDLER_TYPE pre_fault_handler_function)
{
    #if (MAX_PRE_FAULT_HANDLERS > 0)
        Callback__Register(&Callback_Control_Pre_Fault, pre_fault_handler_function);
    #endif
}


//---------------------------------------------------------------------------------------------------------------------
/**
 * Reset all fault observers.
 * This function sets a flag which will reset all faults later.
 * This strategy ensures that the faults are cleared while the AppMgr thread is running.
 */
void Fault__ResetAllObservers(void)
{
    // Faults were cleared so remove all active faults.
    Fault.Reset_All_Observers = TRUE;
}


//---------------------------------------------------------------------------------------------------------------------
/**
 * Set the cycle label for the cycle that is currently running.
 * This function is used to implement accelerated fault detection in test cycles.
 * @param compartment = The compartment in which the active fault should be reset.
 * @param cycle_label = The label associated with the cycle in GESE.
 */
void Fault__SetTestEngaged(BOOL_TYPE engaged)
{
    if (Fault_Nv.Accelerate_Faults != engaged)
    {
        Fault_Nv.Accelerate_Faults = engaged;
        if (engaged == TRUE)
        {
            // Reset all the fault observer state machines.
            memset(Fault_Nv.Observers, 0, sizeof(Fault_Nv.Observers));

            // Reset the highest priority fault and pre-fault since there should be none.
            memset(Prefault_Id, STATE_FAULT_OBSERVER_NONE, sizeof(Prefault_Id));
            memset(Fault_Id, STATE_FAULT_OBSERVER_NONE, sizeof(Fault_Id));
        }
    }
}


//---------------------------------------------------------------------------------------------------------------------
/**
 * Unregister a function handler so it will not be called when any fault occurs.
 * @param fault_handler_function = Pointer to the fault event handler function.
 */
void Fault__UnregisterFaultEvents(FAULT_EVENT_HANDLER_TYPE fault_handler_function)
{
    #if (MAX_FAULT_HANDLERS > 0)
        Callback__Unregister(&Callback_Control_Fault, fault_handler_function);
    #endif
}


//---------------------------------------------------------------------------------------------------------------------
/**
 * Unregister a function handler so it will not be called when any pre-fault occurs.
 * @param pre_fault_handler_function = Pointer to the pre-fault event handler function.
 */
void Fault__UnregisterPreFaultEvents(PRE_FAULT_EVENT_HANDLER_TYPE pre_fault_handler_function)
{
    #if (MAX_PRE_FAULT_HANDLERS > 0)
        Callback__Unregister(&Callback_Control_Pre_Fault, pre_fault_handler_function);
    #endif
}


//=====================================================================================================================
//  --- Private Methods -----------------------------------------------------------------------------------------------
//=====================================================================================================================


//---------------------------------------------------------------------------------------------------------------------
/**
 * Execute the specified function for the fault debounce method associated with the state machine state.
 * This function will also post the fault debounce method's return value as an event.
 * @param function_id = ID of the function to execute. This value is not checked for validity.
 *          It must be FDM_SETUP, FDM_CONDITION_DETECTED, FDM_CONDITION_REMOVED, or FDM_TIME_PASSED.
 */
static void ExecuteFaultDebounceMethod(FAULT_DEBOUNCE_FUNCTION_ID_TYPE function_id)
{
    uint8 method_id;
    FAULT_DEBOUNCE_FUNCTION_TYPE func;

    method_id = Fault.Debounce[Fault.Instance]->Debounce_Method;
    if (method_id < ELEMENTS_IN_ARRAY(DEBOUNCE_METHODS))
    {
        func = DEBOUNCE_METHODS[method_id][function_id];
        FAULT_DEBOUNCE_EVENT_TYPE event = func(Fault.Debounce[Fault.Instance], &Fault_Nv.Observers[Fault.Instance].Fdm);
        // If function_id is FDM_SETUP, then the state machine may be in the middle of a transition -- suppress event.
        if (function_id != FDM_SETUP)
        {
            ExternalEventDebounce(event);
        }
    }
}


//---------------------------------------------------------------------------------------------------------------------
/**
 * Find the setting file fault parameters for the specified fault.
 * @param fault_id = The fault ID used to search the setting file for fault parameters.
 * @param priority = Reference priority to set with the priority of the specified fault.
 * @return A pointer to the setting file data structure with the fault parameters.
 *          If there is no setting file data structure for the specified fault_id, returns NULL.
 */
static FAULT_CONFIG_TYPE* FindConfigParameters(FAULT_ID_TYPE fault_id, uint8* priority)
{
    FAULT_CONFIG_TYPE* config = NULL;
    if (Fault.List == NULL)
    {
        uint8 p = 0;
        while (config == NULL)
        {
            FAULT_CONFIG_TYPE* check = GetConfigParameters(p);
            if (check == NULL)
            {
                break;                                  // fault_id not found -- Return NULL
            }
            if (check->Id == fault_id)
            {
                *priority = p;
                config = check;
            }
            else
            {
                p++;
            }
        }
    }
    else
    {
        for (uint8 p = 0; p < Fault.List->Number_Of_Faults; p++)
        {
            if (Fault.List->Fault_Ids[p] == fault_id)
            {
                *priority = p;
                config = GetConfigParameters(p);
                break;                              // Break out of the for() loop.
            }
        }
    }

    return config;
}


//---------------------------------------------------------------------------------------------------------------------
/**
 * Find and return the existing observer of the specified fault.
 * @param fault_id = The fault ID to search for.
 * @return The fault observer that is handling the specified fault_id.
 *         Return UCHAR_MAX if no fault observer is handling the specified fault_id.
 */
static uint8 FindExistingObserver(FAULT_ID_TYPE fault_id)
{
    // If there is already an observer for this fault, then return it.
    for (uint8 observer = 0; observer < MAX_PARALLEL_FAULT_OBSERVERS; observer++)
    {
        if ((Fault_Nv.Observers[observer].State != STATE_FAULT_OBSERVER_NONE) &&
            (Fault.Config[observer]->Id == fault_id))
        {
            return observer;
        }
    }

    return UCHAR_MAX;
}


//---------------------------------------------------------------------------------------------------------------------
/**
 * Get the fault observer handling the highest priority active fault in a specified compartment.
 * @param compartment = The compartment to search for an active fault.
 * @return The fault observer that is handling the highest priority active fault in the specified compartment.
 *         Return UCHAR_MAX if no fault is active in the specified compartment.
 */
static uint8 GetActiveFaultObserver(uint8 compartment)
{
    uint8 observer = UCHAR_MAX;
    uint8 clear_without_remove_priority = UCHAR_MAX;
    uint8 clear_after_remove_priority = UCHAR_MAX;
    for (uint8 observer_candidate = 0; observer_candidate < MAX_PARALLEL_FAULT_OBSERVERS; observer_candidate++)
    {
        if ((Fault_Nv.Observers[observer_candidate].State == STATE_FAULT_OBSERVER_FAULT) &&
			(Fault.Config[observer_candidate]->Compartment == compartment))
        {
            uint8 priority = Fault_Nv.Observers[observer_candidate].Priority;
            if (Fault.Config[observer_candidate]->Allow_Clear_Without_Remove == FALSE)
            {
                // This fault observer is observing a fault that can only be cleared after
                // removing the error condition. Any fault in this group has priority over any
                // fault in the group below represented by 'clear_without_remove_priority'.
                if (clear_after_remove_priority > priority)
                {
                    observer = observer_candidate;
                    clear_after_remove_priority = priority;
                }
            }
            else if (clear_after_remove_priority == UCHAR_MAX)
            {
                // This fault observer is observing a fault that can be cleared without first
                // removing the error condition.
                if (clear_without_remove_priority > priority)
                {
                    observer = observer_candidate;
                    clear_without_remove_priority = priority;
                }
            }
        }
    }
    return observer;
}


//---------------------------------------------------------------------------------------------------------------------
/**
 * Get the fault observer handling the highest priority active Prefault in a specified compartment.
 * @param compartment = The compartment to search for an active Prefault.
 * @return The fault observer that is handling the highest priority active Prefault in the specified compartment.
 *         Return UCHAR_MAX if no Prefault is active in the specified compartment.
 */
static uint8 GetActivePreFaultObserver(uint8 compartment)
{
    uint8 observer = UCHAR_MAX;
    uint8 highest_priority = UCHAR_MAX;
    for (uint8 i = 0; i < MAX_PARALLEL_FAULT_OBSERVERS; i++)
    {
        if ((Fault_Nv.Observers[i].State == STATE_FAULT_OBSERVER_PRE_FAULT) &&
			(Fault.Config[i]->Compartment == compartment) &&            
            (Fault_Nv.Observers[i].Priority < highest_priority))
        {
            observer = i;
            highest_priority = Fault_Nv.Observers[i].Priority;
        }
    }

    return observer;
}


//---------------------------------------------------------------------------------------------------------------------
/**
 * Get the setting file fault parameters for the fault with the specified priority.
 * @param priority = The priority of the fault whose configuration data is requested.
 *          0 is the highest priority. 255 is the lowest priority.
 * @return A pointer to the setting file data structure with the fault parameters.
 *          If a failure occurs, returns NULL.
 */
static FAULT_CONFIG_TYPE* GetConfigParameters(uint8 priority)
{
    SETTINGFILE_LOADER_TYPE loader;

    if (SettingFile__BasicLoader(SF_PTR_ACU_FAULT_CONFIGURATION, priority, &loader) == PASS)
    {
        return (FAULT_CONFIG_TYPE*)(loader.Data);//lint !e927 Suppress Info: cast from pointer to pointer [MISRA 2004 Rule 11.4]
    }

    return NULL;
}


//---------------------------------------------------------------------------------------------------------------------
/**
 * Get the setting file parameters for the specified activation method.
 * @param debounce_method_displ = The specified activation method.
 * @return A pointer to the setting file data structure with the activation method parameters for
 *          both pre-faults (index 0) and faults (index 1). Returns NULL if no activation method
 *          is specified.
 */
static FAULT_DEBOUNCE_TYPE* GetDebounceParameters(uint8 debounce_method_displ)
{
    SETTINGFILE_LOADER_TYPE loader;

    // Get a reference to the fault's activation method data in the setting file.
    if (debounce_method_displ != 0xFF)
    {
        if (SettingFile__BasicLoader(SF_PTR_ACU_FAULT_DATA, debounce_method_displ, &loader) == PASS)
        {
            FdmTimer__DebounceDataSize(loader.Length);
            return (FAULT_DEBOUNCE_TYPE*)(loader.Data); //lint !e927 Suppress Info: cast from pointer to pointer [MISRA 2004 Rule 11.4]
        }
    }

    return (void*)FAULT_DEFAULT_DEBOUNCE_CONFIG;
}


//---------------------------------------------------------------------------------------------------------------------
/**
 * Restore references to the setting file.
 * Do not assume that the references were recovered over a warm/cold reset.
 */
static void RestoreSfReferences(void)
{
    // Get the list of all configured faults.
    SETTINGFILE_LOADER_TYPE loader;
    if (SettingFile__BasicLoader(SF_PTR_ACU_CROSS_PRODUCT_CONFIG, SF_DISPL_SORTED_FAULT_ID_LIST, &loader) == FAIL)
    {
        // The list of sorted faults is not available.
        LOG_ADD_EXCEPTION(MISSING_SORTED_FAULT_LIST, 0);
        Fault.List = NULL;
    }
    else
    {
        // Save a pointer to the list of sorted faults.
        Fault.List = (void*)loader.Data;
    }

    // Restore setting file references for faults that were being observed before the reset.
    FdmTimer__DebounceDataSize(2 * sizeof(FAULT_DEBOUNCE_TYPE));
    for (Fault.Instance = 0; Fault.Instance < MAX_PARALLEL_FAULT_OBSERVERS; Fault.Instance++)
    {
        if (Fault_Nv.Observers[Fault.Instance].State != STATE_FAULT_OBSERVER_NONE)
        {
            Fault.Config[Fault.Instance] = GetConfigParameters(Fault_Nv.Observers[Fault.Instance].Priority);
            if (Fault.Config[Fault.Instance] != NULL)
            {
                if (GetActivePreFaultObserver(Fault.Config[Fault.Instance]->Compartment) == Fault.Instance)
                {
                    // Check the High Priority Pre-fault Observer in Compartement.
                    Prefault_Id[Fault.Config[Fault.Instance]->Compartment] = Fault.Config[Fault.Instance]->Id;
                }

                if (GetActiveFaultObserver(Fault.Config[Fault.Instance]->Compartment) == Fault.Instance)
                {
                    // Check the High Priority Fault Observer in Compartement.
                    Fault_Id[Fault.Config[Fault.Instance]->Compartment] = Fault.Config[Fault.Instance]->Id;
                }

                Fault.Debounce[Fault.Instance] = GetDebounceParameters(Fault.Config[Fault.Instance]->Debounce_Method_Displacement);
                if (Fault_Nv.Observers[Fault.Instance].State == STATE_FAULT_OBSERVER_PRE_FAULT)
                {
                    Fault.Debounce[Fault.Instance] = &Fault.Debounce[Fault.Instance][1];
                }
            }
            else
            {
                Fault_Nv.Observers[Fault.Instance].State = STATE_FAULT_OBSERVER_NONE;
            }
        }
    }
}


//---------------------------------------------------------------------------------------------------------------------
/**
 * Update the fault IDs based on the current fault observer states.
 */
static void UpdateFaultIDs(void)
{
    for (uint8 compartment = 0; compartment < APPLIANCE_MAX_COMPARTMENTS; compartment++)
    {
        uint8 observer = GetActivePreFaultObserver(compartment);
        Prefault_Id[compartment] = (observer < MAX_PARALLEL_FAULT_OBSERVERS) ? Fault.Config[observer]->Id : FAULT_ID_NONE;

        observer = GetActiveFaultObserver(compartment);
        Fault_Id[compartment] = (observer < MAX_PARALLEL_FAULT_OBSERVERS) ? Fault.Config[observer]->Id : FAULT_ID_NONE;
    }
}


//=====================================================================================================================
//  --- Private State Machine Customization Functions -----------------------------------------------------------------
//=====================================================================================================================


//---------------------------------------------------------------------------------------------------------------------
/**
 * Check for a debounce configuration that requires no additional time or no additional events.
 * Trigger an event to transition to the next state in those cases.
 */
static void CheckForNoDebounce(void)
{
    switch (Fault.Debounce[Fault.Instance]->Debounce_Method)
    {
        case 0:                                     // Time-Based debouncing.
            if (Fault_Nv.Observers[Fault.Instance].Fdm.Timer.Time == 0)
            {
                ExternalEventDebounce(FAULT_DEBOUNCE_EVENT_NEXT);
            }
            break;

        case 1:                                     // Event-Based debouncing.
            if (Fault_Nv.Observers[Fault.Instance].Fdm.Counter == 0)
            {
                ExternalEventDebounce(FAULT_DEBOUNCE_EVENT_NEXT);
            }
            break;
        default:
            break;
    }
}


//---------------------------------------------------------------------------------------------------------------------
/**
 * Manage the time-based debouncing of error conditions while looking for a pre-fault or fault.
 */
static void DebounceError(void)
{
    ExecuteFaultDebounceMethod(FDM_TIME_PASSED);
}


//---------------------------------------------------------------------------------------------------------------------
/**
 * Manage the time-based debouncing of error removal while in the fault state.
 */
static void DebounceErrorRemoval(void)
{
    if ((Fault_Nv.Observers[Fault.Instance].Is_Condition_Removed == TRUE) &&
        (Fault.Config[Fault.Instance]->Phase == SF_DISPL_INVALID_VALUE))
    {
        ExecuteFaultDebounceMethod(FDM_TIME_PASSED);
    }
}


//---------------------------------------------------------------------------------------------------------------------
/**
 * Determine whether error detection leads directly to a fault.
 * @return TRUE if the error detection leads directly to a fault; otherwise FALSE.
 */
static BOOL_TYPE DirectToFault(void)
{
    return (BOOL_TYPE)((Fault.Config[Fault.Instance]->Direct_To_Fault) ||
                       (Fault_Nv.Accelerate_Faults == TRUE));
}


//---------------------------------------------------------------------------------------------------------------------
/**
 * Initialize the activation method in preparation to detect a pre-fault.
 */
static void SetupAlarmDebounce(void)
{
    Fault.Debounce[Fault.Instance] = GetDebounceParameters(Fault.Config[Fault.Instance]->Debounce_Method_Displacement);
    ExecuteFaultDebounceMethod(FDM_SETUP);
}


//---------------------------------------------------------------------------------------------------------------------
/**
 * Initialize the activation method in preparation to detect a fault.
 */
static void SetupPreFaultDebounce(void)
{
    Fault.Debounce[Fault.Instance] = &Fault.Debounce[Fault.Instance][1];
    ExecuteFaultDebounceMethod(FDM_SETUP);
}


//---------------------------------------------------------------------------------------------------------------------
/**
 * Trigger fault event handlers to manage the reaction to a fault detection.
 */
static void TriggerFaultReaction(void)
{
    // Save the fault data in Statistics.
    FAULT_CONFIG_TYPE* config = Fault.Config[Fault.Instance];
    int compartment = config->Compartment;
    Statistics__SaveFaultData(compartment, config->Id, config->Code, config->Sub_Code, config->Engineering_Code);

    // Only trigger the fault if this is the highest priority fault in the current compartment.
    if (GetActiveFaultObserver(compartment) == Fault.Instance)
    {
        // Report the fault to the HMI in either of the following cases:
        //      1. The Supervisor is not in the FAULT state.
        //      2. The new Fault will cause the Supervisor to re-enter the FAULT state.
        if ((BIT_TEST(Fault.Managed_Compartments, compartment) == 0) ||
            (config->Phase != UCHAR_MAX))
        {
            // Inform the HMI of the new fault.
            Fault_Id[compartment] = config->Id;
            #if (API018_SERVER_FEATURE == ENABLED)
                API018Diagnostic__PublishFaultBasic(UCHAR_MAX);
            #endif
        }

        Callback__Notify(&Callback_Control_Fault, Fault.Instance);
    }
}


//---------------------------------------------------------------------------------------------------------------------
/**
 * Trigger pre-fault event handlers to manage the reaction to a pre-fault detection.
 */
static void TriggerPreFaultReaction(void)
{
    // Save the fault data in Statistics.
    FAULT_CONFIG_TYPE* config = Fault.Config[Fault.Instance];
    int compartment = config->Compartment;
    Statistics__SavePreFaultData(compartment, config->Id, config->Code, config->Sub_Code, config->Engineering_Code);

    // Update the Prefault_Id if this is the highest priority pre-fault in the current compartment.
    if (GetActivePreFaultObserver(compartment) == Fault.Instance)
    {
        Prefault_Id[compartment] = config->Id;
    }

    Callback__Notify(&Callback_Control_Pre_Fault, Fault.Instance);
}


//=====================================================================================================================
//=== StateEngineCrank (v2.8) Auto-Generated Functions for Fault Observer State Machine
//=====================================================================================================================
// !! StateEngineCrank cannot update this code if you change the header !!


//---------------------------------------------------------------------------------------------------------------------
/**
 * Process an external Debounce event.
 *
 *              >>> DO NOT MODIFY THIS FUNCTION <<<
 *
 * This function was auto-generated and must not be edited manually.
 * Change the UML used to generate this function and regenerate the source code.
 *
 * @param event = The external event to be processed.
 */
static void ExternalEventDebounce(uint8 event)
{
    switch (event)
    {
        case FAULT_DEBOUNCE_EVENT_NEXT:
            switch (Fault_Nv.Observers[Fault.Instance].State)
            {
                case STATE_FAULT_OBSERVER_ALARM:
                    if (DirectToFault() == TRUE)
                    {
                        Fault_Nv.Observers[Fault.Instance].State = STATE_FAULT_OBSERVER_FAULT;
                        TriggerFaultReaction();     // Entry Function.
                        Fault_Observer_Transitioned = TRUE;
                    }
                    else
                    {
                        SetupPreFaultDebounce();    // Transition action function.
                        Fault_Nv.Observers[Fault.Instance].State = STATE_FAULT_OBSERVER_PRE_FAULT;
                        Fault_Observer_Transitioned = FALSE;
                        CheckForNoDebounce();       // Entry Function.
                        if (Fault_Observer_Transitioned == FALSE)
                        {
                            TriggerPreFaultReaction(); // Entry Function.
                        }
                        Fault_Observer_Transitioned = TRUE;
                    }
                    break;

                case STATE_FAULT_OBSERVER_PRE_FAULT:
                    Fault_Nv.Observers[Fault.Instance].State = STATE_FAULT_OBSERVER_FAULT;
                    TriggerFaultReaction();         // Entry Function.
                    Fault_Observer_Transitioned = TRUE;
                    break;

                default:
                    // Event is ignored for all other values of Fault_Nv.Observers[Fault.Instance].State.
                    break;
            }
            break;

        case FAULT_DEBOUNCE_EVENT_CANCEL:
            switch (Fault_Nv.Observers[Fault.Instance].State)
            {
                case STATE_FAULT_OBSERVER_ALARM:
                case STATE_FAULT_OBSERVER_PRE_FAULT:
                case STATE_FAULT_OBSERVER_FAULT:
                    Fault_Nv.Observers[Fault.Instance].State = STATE_FAULT_OBSERVER_NONE; // Terminate Fault Observer state machine execution.
                    Fault_Observer_Transitioned = TRUE;
                    break;

                default:
                    // Event is ignored for all other values of Fault_Nv.Observers[Fault.Instance].State.
                    break;
            }
            break;

        case FAULT_DEBOUNCE_EVENT_REPEAT:
            switch (Fault_Nv.Observers[Fault.Instance].State)
            {
                case STATE_FAULT_OBSERVER_PRE_FAULT:
                    Fault_Nv.Observers[Fault.Instance].State = STATE_FAULT_OBSERVER_PRE_FAULT;
                    Fault_Observer_Transitioned = FALSE;
                    CheckForNoDebounce();           // Entry Function.
                    if (Fault_Observer_Transitioned == FALSE)
                    {
                        TriggerPreFaultReaction();  // Entry Function.
                    }
                    Fault_Observer_Transitioned = TRUE;
                    break;

                default:
                    // Event is ignored for all other values of Fault_Nv.Observers[Fault.Instance].State.
                    break;
            }
            break;

        default:
            // All other external Debounce events are ignored by the Fault Observer state machine.
            break;
    }
}


//---------------------------------------------------------------------------------------------------------------------
/**
 * The main execution function for the Fault Observer state machine.
 * This function should be called periodically while the state machine is running.
 *
 *              >>> DO NOT MODIFY THIS FUNCTION <<<
 *
 * This function was auto-generated and must not be edited manually.
 * Change the UML used to generate this function and regenerate the source code.
 */
static void FaultObserverExecute(void)
{
    Fault_Observer_Transitioned = FALSE;
    switch(Fault_Nv.Observers[Fault.Instance].State)
    {
        case STATE_FAULT_OBSERVER_ALARM:
        case STATE_FAULT_OBSERVER_PRE_FAULT:
            DebounceError();                        // Do function.
            break;

        case STATE_FAULT_OBSERVER_FAULT:
            DebounceErrorRemoval();                 // Do function.
            break;

        default:
            // There is nothing to do for all other values of Fault_Nv.Observers[Fault.Instance].State.
            break;
    }
}


//---------------------------------------------------------------------------------------------------------------------
/**
 * The initialization function for the Fault Observer state machine.
 * This function resets the state machine to the initial state and executes the initial state's
 * entry function.
 *
 *              >>> DO NOT MODIFY THIS FUNCTION <<<
 *
 * This function was auto-generated and must not be edited manually.
 * Change the UML used to generate this function and regenerate the source code.
 */
static void FaultObserverInitialize(void)
{
    Fault_Nv.Observers[Fault.Instance].State = STATE_FAULT_OBSERVER_ALARM;
    Fault_Observer_Transitioned = FALSE;
    SetupAlarmDebounce();                           // Entry Function.
    if (Fault_Observer_Transitioned == FALSE)
    {
        CheckForNoDebounce();                       // Entry Function.
    }
    Fault_Observer_Transitioned = TRUE;
}


//---------------------------------------------------------------------------------------------------------------------
/**
 * The termination function for the Fault Observer state machine.
 * This function disables the state machine. Calls to StateMachineExecute() will have no effect.
 * The StateMachineInitialize() function must be called again to restart the state machine.
 * If the current state has an exit function, it will be called.
 *
 *              >>> DO NOT MODIFY THIS FUNCTION <<<
 *
 * This function was auto-generated and must not be edited manually.
 * Change the UML used to generate this function and regenerate the source code.
 */
static void FaultObserverTerminate(void)
{
    // None of the states have an Exit function.
    Fault_Nv.Observers[Fault.Instance].State = STATE_FAULT_OBSERVER_NONE;
    Fault_Observer_Transitioned = TRUE;
}


// !! StateEngineCrank cannot update this code if you change the footer !!
// End of StateEngineCrank Auto-Generated Code.
