/**
 *  @file
 *
 *  @brief      Interface for basic filters that can be used throughout the firmware.
 *
 *  @details    The module supports an IIR filter and a glitch filter.
 *
 *  @section    Applicable_Documents
 *                  List here all the applicable documents if needed. <tr>
 *
 *  $Header: Filter.c
 *
 *  @copyright  Copyright 2016-$Date$. Whirlpool Corporation. All rights reserved - CONFIDENTIAL
 */
//---------------------------------------------------------------------------------------------------------------------
//---------------------------------------------------------------------------------------------------------------------



//-------------------------------------- Include Files ----------------------------------------------------------------

// -- This Module --
#include "C_Extensions.h"
#include "Filter.h"

// -- Other Modules --
#include "Log.h"


//-------------------------------------- PUBLIC (Variables) -----------------------------------------------------------

//-------------------------------------- PRIVATE (Variables, Constants & Defines) -------------------------------------

// -- Private Constant Declarations --

//! The maximum bit value for the Alpha used on the IIR filter.
//! A maximum bit value of 15 results in the heaviest filtering provided by an alpha of 1/32768.
#define IIRFILTER_MAX_COEFFICIENT_BIT   15

//! The name of this module for use by the Log module.
#define MODULE_NAME MODULE_FILTERS


// -- Private Enumerated Constants Declarations --

//! A list of log message IDs that are generated by this module.
typedef enum MODULE_FILTERS_LOG_MESSAGE_ID_ENUM
{
    UNSUPPORTED_FILTER_TYPE = 1
} MODULE_FILTERS_LOG_MESSAGE_ID_TYPE;


//-------------------------------------- PRIVATE (Function Prototypes) ------------------------------------------------


//=====================================================================================================================
//-------------------------------------- Public Functions -------------------------------------------------------------
//=====================================================================================================================


//---------------------------------------------------------------------------------------------------------------------
/**
 * Initialize the filter data structure.
 * @param filter_struct = The structure used by the filter.
 * @param initial_value = The initial value that the filter should be set to.
 * @param filter_type = The type of filter that is being initialized.
 */
void Filter__Initialize(void* filter_struct, FILTER_DATA_TYPE initial_value, FILTER_TYPE filter_type)
{
    IIR_FILTER_MEASURE_TYPE* iir_filter;
    GLITCH_FILTER_MEASURE_TYPE* glitch_filter;

    switch (filter_type)
    {
        case FILTER_IIR:
        	{
				// Convert the inverted alpha to the number of bits that will be shifted.
				iir_filter = (IIR_FILTER_MEASURE_TYPE*)filter_struct;

            	#if (FILTER_FLOATING_POINT_CAPABLE == DISABLED)
            	uint16 i = 0;
                for (i = IIRFILTER_MAX_COEFFICIENT_BIT; i > 0; i--)
                {
                    if (BIT_TEST(iir_filter->Inverted_Alpha, i))
                        break;
                }
                iir_filter->Inverted_Alpha = i;

                // Setup the Accumulator value.
                iir_filter->Accumulator = initial_value << iir_filter->Inverted_Alpha;
            	#endif

                iir_filter->Filtered_Value = initial_value;
        	}
            break;

        case FILTER_GLITCH:
            glitch_filter = (GLITCH_FILTER_MEASURE_TYPE*)filter_struct;
            glitch_filter->Filtered_Value = initial_value;
            glitch_filter->Was_Measure_Init = TRUE;
            break;

        default:
            LOG_ADD_EXCEPTION(UNSUPPORTED_FILTER_TYPE, filter_type);
            break;
    }
}


//---------------------------------------------------------------------------------------------------------------------
/**
 * Update the filter variables based on a new sampled value.
 * @param filter_struct = The structure used by the filter.
 * @param new_sample_value = The new sampled value that should be considered by the filter.
 * @param filter_type = The type of filter that is being updated.
 */
void Filter__Update(void* filter_struct, FILTER_DATA_TYPE new_sample_value, FILTER_TYPE filter_type)
{
    IIR_FILTER_MEASURE_TYPE* iir_filter;
    GLITCH_FILTER_MEASURE_TYPE* glitch_filter;
    FILTER_DATA_TYPE value;

    switch(filter_type)
    {
        case FILTER_IIR:
            iir_filter = ((IIR_FILTER_MEASURE_TYPE*)filter_struct);
            #if (FILTER_FLOATING_POINT_CAPABLE == ENABLED)
                iir_filter->Filtered_Value += (new_sample_value - iir_filter->Filtered_Value) / iir_filter->Inverted_Alpha;
            #else
                iir_filter->Accumulator += new_sample_value - iir_filter->Filtered_Value;
                value = iir_filter->Accumulator;

                if (iir_filter->Inverted_Alpha > 1)
                {
                    value >>= iir_filter->Inverted_Alpha - 1;
                }
                if (iir_filter->Inverted_Alpha > 0)
                {
                    value += 1;
                    value >>= 1;
                }
                iir_filter->Filtered_Value = value;
            #endif
            break;

        case FILTER_GLITCH:
            glitch_filter = (GLITCH_FILTER_MEASURE_TYPE*)filter_struct;
            if (glitch_filter->Was_Measure_Init == TRUE)
            {
                // Calculate the ABS delta
                if (glitch_filter->Filtered_Value > new_sample_value)
                {
                    value = glitch_filter->Filtered_Value - new_sample_value;
                }
                else
                {
                    value = new_sample_value - glitch_filter->Filtered_Value;
                }

                if ((glitch_filter->Debounce_Cnt < glitch_filter->Debounce_Threshold) &&
                    (value >= (FILTER_DATA_TYPE)glitch_filter->Remove_Threshold))
                {
                    new_sample_value = glitch_filter->Filtered_Value;
                    glitch_filter->Debounce_Cnt++;
                }
                else
                {
                    glitch_filter->Debounce_Cnt = 0;
                }
            }
            glitch_filter->Filtered_Value = new_sample_value;
            glitch_filter->Was_Measure_Init = TRUE;
            break;

        default:
            LOG_ADD_EXCEPTION(UNSUPPORTED_FILTER_TYPE, filter_type);
            break;
    }
}


//=====================================================================================================================
//-------------------------------------- Private Functions ------------------------------------------------------------
//=====================================================================================================================

