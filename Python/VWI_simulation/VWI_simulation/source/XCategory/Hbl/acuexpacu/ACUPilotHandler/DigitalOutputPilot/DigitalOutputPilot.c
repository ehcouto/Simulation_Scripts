/**
 *  @file       
 *
 *  @brief      Implements DigitalOutputPilot module.
 *
 *  @copyright  Copyright 2015-$Date: 2015/07/14 17:37:54EDT $. Whirlpool Corporation. All rights reserved - CONFIDENTIAL
 */
//---------------------------------------------------------------------------------------------------------------------

//-------------------------------------- Include Files ----------------------------------------------------------------
// -- This Module --
#include "SystemConfig.h"
#include "DigitalOutputPilot.h"

// -- Other Modules --
#if (HBL_PILOT_NUM_DIGITALOUTPUT > 0)
#include "Gpio.h"
#include "Log.h"
#include "VirtualPin.h"

#include <String.h>

//-------------------------------------- PRIVATE (Variables, Constants & Defines) -------------------------------------

//! A list of log message IDs that are generated by this module.
typedef enum
{
    INVALID_VIRTUAL_PIN = 0     //!< data: the invalid virtual pin number being passed
} MODULE_DIGITALOUTPUTPILOT_MESSAGE_ID_TYPE;
#define MODULE_NAME MODULE_DIGITALOUTPUTPILOT       //!< The name of this module for use by the Log module.


//! Tracks the number of digital output pilot allocations.
static uint8 DigitalOutputPilot_Allocation;

//! Digital output pilot data type definition.
typedef struct
{
    uint8 Requested;
    uint8 Processed;
} DIGITALOUTPUTPILOT_DATA_TYPE;

//! Digital output pilot data array. One entry per pilot instance.
static DIGITALOUTPUTPILOT_DATA_TYPE DigitalOutputPilot_Data[HBL_PILOT_NUM_DIGITALOUTPUT];

//-------------------------------------- PRIVATE (Function Prototypes) ------------------------------------------------
static void DoPinUpdate(HBL_LOAD_TYPE * load);
static BOOL_TYPE GetVirtualPinNumber(HBL_LOAD_TYPE *load, uint8 * virtual_pin);

//-------------------------------------- PUBLIC (Variables) -----------------------------------------------------------

//=====================================================================================================================
//-------------------------------------- Public Functions -------------------------------------------------------------
//=====================================================================================================================
//---------------------------------------------------------------------------------------------------------------------
/**
 *  @brief      It Initializes the module StepperPilot and its variables
 */
void DigitalOutputPilot__Initialize(void)
{
    DigitalOutputPilot_Allocation = 0;
    memset(DigitalOutputPilot_Data,0,sizeof(DigitalOutputPilot_Data));
}


//---------------------------------------------------------------------------------------------------------------------
/**
 *  @brief      Allocate pilot instance for digital output.
 *
 *  @return     uint8 result - Allocation result.
 *  @retval     0-254 - Pilot allocation instance.
 *  @retval     0xFF - Allocation failed.
 */
uint8 DigitalOutputPilot__Allocate(void)
{
    uint8 retval;

    retval = 0xFF;

    if (DigitalOutputPilot_Allocation < HBL_PILOT_NUM_DIGITALOUTPUT)
    {
        retval = DigitalOutputPilot_Allocation;
        DigitalOutputPilot_Allocation++;
    }

    return (retval);
}

//---------------------------------------------------------------------------------------------------------------------
/**
 *  @brief      Initialize digital output pilot instance.
 *
 *  @param      HBL_LOAD_TYPE *load - Pointer to associated digital output load instance.
 *
 *  @return     PASS_FAIL_TYPE result - Result of digital output pilot instance initialization.
 *  @retval     PASS - Instance initialization succeeded.
 *  @retval     FAIL - Instance initialization failed.
 */
PASS_FAIL_TYPE DigitalOutputPilot__InitializeInstance(HBL_LOAD_TYPE * load)
{
    PASS_FAIL_TYPE retval = FAIL;
    uint8 virtual_pin;

    if ((load->Pilot_Data_Index < DigitalOutputPilot_Allocation) &&
        (GetVirtualPinNumber(load, &virtual_pin) == TRUE) &&
        (VIRTUALPIN_TABLE[virtual_pin].port != PORT_NULL))
    {
        Gpio__PinConfig(VIRTUALPIN_TABLE[virtual_pin].port, VIRTUALPIN_TABLE[virtual_pin].pin, VIRTUALPIN_TABLE[virtual_pin].pin_config);

        // Shortcut to set pin output values according to load status at initialization
        DoPinUpdate(load);
        retval = PASS;
    }

    return (retval);
}

//---------------------------------------------------------------------------------------------------------------------
/**
 *  @brief      Set digital output pilot instance request.
 *
 *  @param      HBL_LOAD_TYPE *load - Pointer to associated digital output load instance.
 *
 *  @param      void *data - Pointer to request data. Pass argument as uint8 *.
 *
 *  @return     PASS_FAIL_TYPE result - Result of digital output pilot request.
 *  @retval     PASS - Instance request succeeded.
 *  @retval     FAIL - Instance request failed.
 */
PASS_FAIL_TYPE DigitalOutputPilot__Request(HBL_LOAD_TYPE * load, void * data)
{
    PASS_FAIL_TYPE result;

    result = FAIL;

    if (load->Pilot_Data_Index < DigitalOutputPilot_Allocation)
    {
        DigitalOutputPilot_Data[load->Pilot_Data_Index].Requested = *((uint8 *)data);
        result = PASS;
    }

    return (result);
}

//---------------------------------------------------------------------------------------------------------------------
/**
 *  @brief      Process digital output pilot instance.
 *
 *  @param      HBL_LOAD_TYPE *load - Pointer to digital output load instance.
 *
 *  @return     PASS_FAIL_TYPE result - Result of digital output pilot instance process.
 *  @retval     PASS - Instance process succeeded.
 *  @retval     FAIL - Instance process failed.
 */
PASS_FAIL_TYPE DigitalOutputPilot__Process(HBL_LOAD_TYPE * load)
{
    PASS_FAIL_TYPE retval;

    retval = FAIL;

    if (load->Pilot_Data_Index < DigitalOutputPilot_Allocation)
    {
        DigitalOutputPilot_Data[load->Pilot_Data_Index].Processed = DigitalOutputPilot_Data[load->Pilot_Data_Index].Requested;
        DoPinUpdate(load);
        retval = PASS;
    }

    return (retval);
}

//---------------------------------------------------------------------------------------------------------------------
/**
 *  @brief      Get current digital output pilot instance request.
 *
 *  @param      HBL_LOAD_TYPE *load - Pointer to associated digital output load instance.
 *
 *  @return     void *requested - Requested instance data.
 *  @retval     Address of requested instance data. Cast it using *((uint8 *)ptr) to get values.
 *  @retval     NULL - Invalid load index.
 */
void * DigitalOutputPilot__GetRequested(HBL_LOAD_TYPE * load)
{
    void * requested;

    requested = NULL;

    if (load->Pilot_Data_Index < DigitalOutputPilot_Allocation)
    {
        requested =  &(DigitalOutputPilot_Data[load->Pilot_Data_Index].Requested);
    }

    return (requested);
}

//---------------------------------------------------------------------------------------------------------------------
/**
 *  @brief      Get digital output pilot instance processed request.
 *
 *  @param      HBL_LOAD_TYPE *load - Pointer to associated digital output load instance.
 *
 *  @return     void * processed - Processed instance data.
 *  @retval     Address of processed instance data. Cast it using *((uint8 *)ptr) to get values.
 *  @retval     NULL - Invalid load index.
 */
void * DigitalOutputPilot__GetProcessed(HBL_LOAD_TYPE * load)
{
    void * processed;

    processed = NULL;

    if (load->Pilot_Data_Index < DigitalOutputPilot_Allocation)
    {
        processed =  &(DigitalOutputPilot_Data[load->Pilot_Data_Index].Processed);
    }

    return (processed);
}

//---------------------------------------------------------------------------------------------------------------------
/**
 *  @brief      Get digital output instance status.
 *
 *  @param      HBL_LOAD_TYPE *load - Pointer to digital output load instance.
 *
 *  @return     void *status - instance Status.
 *  @retval     Address of instance Status. Cast it using *((uint8 *)ptr) to get the value.
 *  @retval     NULL - Invalid load index.
 */
void * DigitalOutputPilot____GetStatus(HBL_LOAD_TYPE *load)
{
    void *status;

    status = NULL;

    if (load != NULL)
    {
        if (load->Pilot_Data_Index < DigitalOutputPilot_Allocation)
        {
            status = &(DigitalOutputPilot_Data[load->Pilot_Data_Index].Processed);
        }
    }

    return (status);
}

//=====================================================================================================================
//-------------------------------------- Private Functions ------------------------------------------------------------
//=====================================================================================================================
//---------------------------------------------------------------------------------------------------------------------
/**
 *  @brief      Update virtual pin according to processed value.
 *
 *  @param      HBL_LOAD_TYPE *load - Pointer to digital output load instance.
 */
static void DoPinUpdate(HBL_LOAD_TYPE * load)
{
	uint8 virtual_pin;
	if ((GetVirtualPinNumber(load, &virtual_pin) == TRUE) &&
	    (VIRTUALPIN_TABLE[virtual_pin].port != PORT_NULL))
	{
	    uint8 pin_val = (DigitalOutputPilot_Data[load->Pilot_Data_Index].Processed != 0)?1:0;

		// Invert pin value according to Hi Low Activation Bitmap
		pin_val ^= ~load->Hi_Low_Activation_Bitmap;
		pin_val &= 0x01;

		Gpio__PinWrite(VIRTUALPIN_TABLE[virtual_pin].port, VIRTUALPIN_TABLE[virtual_pin].pin, (BOOL_TYPE)pin_val);
	}
}


//---------------------------------------------------------------------------------------------------------------------
/**
 *  @brief      Determines if the Virtual pin specified in the load is valid.
 *
 *  @param      HBL_LOAD_TYPE *load - Pointer to associated digital output load instance.
 *
 *  @param      *virtual_pin - returns the virtual pin number specified in the load instance to the calling function
 *
 *  @return     TRUE - the load instance defined a valid virtual pin
 *  @retval     FALSE - the load instance defined an invalid virtual pin
 */
static BOOL_TYPE GetVirtualPinNumber(HBL_LOAD_TYPE *load, uint8 *virtual_pin)
{
    BOOL_TYPE ret_val = TRUE;
    *virtual_pin = load->Pin_Ptr[0];
    if ( *virtual_pin >= VirtualPin__GetNumOf() )
    {
        LOG_ADD_EXCEPTION(INVALID_VIRTUAL_PIN, *virtual_pin);
        ret_val = FALSE;
    }
    return (ret_val);
}


#endif
