/**
 *  @file
 *
 *  @brief      Implementation for the Magnetron Pilot Mains Sampler.
 *
 *  @details    Detailed description of the file contents
 *
 *  @copyright  Copyright 2018 Whirlpool Corporation. All rights reserved - CONFIDENTIAL
 */
//---------------------------------------------------------------------------------------------------------------------
//---------------------------------------------------------------------------------------------------------------------

//-------------------------------------- Include Files ----------------------------------------------------------------
#include "SystemConfig.h"

#if (HBL_PILOT_NUM_MAGNETRON > 0)
#include "MagnetronPilotMainsSampler.h"
#include "MagnetronPilotMainsSampler_prv.h"
#include "Hbl.h"
#include "Log.h"
#include "Gpio.h"
#include "VirtualPin.h"

#include <string.h>

//  --- Private Declarations ------------------------------------------------------------------------------------------
//! Enumeration for mains detection state.
typedef enum
{
    MAINS_DETECT_STATE_UNKNOWN = 0,
    MAINS_DETECT_STATE_LOST,
    MAINS_DETECT_STATE_FOUND
}MAINS_DETECTION_STATE_TYPE;

//! Mains Sampler data type declaration.
typedef PACKED struct MAINS_SAMPLER_DATA_STRUCT
{
    uint8 Mains_Feedback_Pin;
    uint8 AC_Mains_Same_Phase                     : 1;
    MAINS_DETECTION_STATE_TYPE Mains_Detect_State : 2;    //!< Mains detect state.
    uint8 Mains_Detect_State_Changed              : 1;
    uint8 Mains_Detect_Early_Warning              : 1;
    MAINS_FREQUENCY_TYPE Mains_Freq_State         : 1;    //!< Mains signal frequency state.
    uint8 High_Pulse                              : 1;
    uint8 Mains_Period;
    uint8 Counter;
    uint8 High_Counter;
    uint8 Low_Counter;
    uint8 Zero_Cross_LH_Cnt1;
    uint8 Zero_Cross_HL_Cnt2;
    uint8 L_Pos_Cnt;
    uint8 L_Neg_Cnt;
    uint8 Max_Count;
    uint8 Min_High_Level_Count;
    uint8 Min_Low_Level_Count;
    uint8 Max_L_Pos_Count;
    uint8 Min_L_Pos_Count;
    uint8 Mains_Period_Wait_Counter;
    uint8 Mains_Period_Resume_Counter;
} MAINS_SAMPLER_DATA_TYPE;

//! The name of this module for use by the Log module.
#define MODULE_NAME MODULE_MAGNETRON_PILOT_MAINS_SAMPLER

//! A list of log message IDs that are generated by this module.
typedef enum MODULE_MAGNETRON_PILOT_MAINS_SAMPLER_LOG_MESSAGE_ID_ENUM
{
    MAINS_SIGNAL_FOUND                                  = 1,
    MAINS_SIGNAL_EARLY_WARNING                          = 2,
    MAINS_SIGNAL_LOST                                   = 3,
} MODULE_MAGNETRON_PILOT_MAINS_SAMPLER_LOG_MESSAGE_ID_TYPE;

//  --- Private Definitions -------------------------------------------------------------------------------------------
//! Pilot index for current running magnetron state machine.
static uint8 Pilot_Index;

//! Mains sampler data.
static MAINS_SAMPLER_DATA_TYPE Mains_Sampler_Data[HBL_PILOT_NUM_MAGNETRON];

//  --- Private Function Prototypes -----------------------------------------------------------------------------------
static void MainsSamplerRecalcEvents(uint8 count);
static void MainsSamplerMainsLostDetection(void);
static void MainsSamplerMainsFoundDetection(void);

//=====================================================================================================================
//-------------------------------------- Public Functions -------------------------------------------------------------
//=====================================================================================================================
//---------------------------------------------------------------------------------------------------------------------
/**
 *  @brief      It Initializes the module MagnetronPilotMainsSampler and its variables
 */
void MagnetronPilotMainsSampler__Initialize(void)
{
    Pilot_Index = 0;
    memset(Mains_Sampler_Data, 0, sizeof(Mains_Sampler_Data));
}

//---------------------------------------------------------------------------------------------------------------------
/**
 *  @brief      Initialize magnetron pilot Mains Sampler instance.
 *
 *  @param      uint8 Pilot_Index - Index to associated magnetron Pilot instance.
 *              uint8 AC_Mains_Same_Phase - Flag to indicate AC and mains phase: True: Same Phase / False: Reversed Phaser.
 *              uint8 Mains_Feedback_Pin - Index into virtual pin table to find the Mains feedback signal.
 *
 *  @return     void
 */
void MagnetronPilotMainsSampler__InitializeInstance(uint8 Parent_Pilot_Index, uint8 AC_Mains_Same_Phase, uint8 Mains_Feedback_Pin)
{
    uint8 table_index;

    Pilot_Index = Parent_Pilot_Index;

    Mains_Sampler_Data[Pilot_Index].AC_Mains_Same_Phase = AC_Mains_Same_Phase;
    Mains_Sampler_Data[Pilot_Index].Mains_Feedback_Pin = Mains_Feedback_Pin;

    //! Initialize mains pin
    table_index = Mains_Sampler_Data[Pilot_Index].Mains_Feedback_Pin;
    if (VIRTUALPIN_TABLE[table_index].port != PORT_NULL)
    {
        Gpio__PinConfig(VIRTUALPIN_TABLE[table_index].port, VIRTUALPIN_TABLE[table_index].pin, VIRTUALPIN_TABLE[table_index].pin_config);
    }

    //! Initialize mains parameter
    Mains_Sampler_Data[Pilot_Index].Mains_Period = ONE_PERIOD_COUNT_60HZ;
    Mains_Sampler_Data[Pilot_Index].Counter = MAX_COUNT_60HZ;
    Mains_Sampler_Data[Pilot_Index].High_Counter = 0;
    Mains_Sampler_Data[Pilot_Index].Low_Counter = MAX_COUNT_60HZ;
    Mains_Sampler_Data[Pilot_Index].Max_Count = MAX_COUNT_50HZ;
    Mains_Sampler_Data[Pilot_Index].Min_High_Level_Count = MIN_HIGH_LEVEL_COUNT_60HZ;
    Mains_Sampler_Data[Pilot_Index].Min_Low_Level_Count = MIN_LOW_LEVEL_COUNT_60HZ;
    Mains_Sampler_Data[Pilot_Index].Max_L_Pos_Count = MAX_L_POS_COUNT_50HZ;
    Mains_Sampler_Data[Pilot_Index].Min_L_Pos_Count = MIN_L_POS_COUNT_60HZ;
    Mains_Sampler_Data[Pilot_Index].High_Pulse = 0;
    Mains_Sampler_Data[Pilot_Index].Mains_Detect_State = MAINS_DETECT_STATE_UNKNOWN;
    Mains_Sampler_Data[Pilot_Index].Mains_Detect_State_Changed = FALSE;
    Mains_Sampler_Data[Pilot_Index].Mains_Detect_Early_Warning = FALSE;
    Mains_Sampler_Data[Pilot_Index].Mains_Freq_State = MAINS_FREQ_ERROR;
    Mains_Sampler_Data[Pilot_Index].Mains_Period_Wait_Counter = 0;
    Mains_Sampler_Data[Pilot_Index].Mains_Period_Resume_Counter = 0;
    MainsSamplerRecalcEvents(DEFAULT_L_POS_COUNT_60HZ);
}

//---------------------------------------------------------------------------------------------------------------------
/**
 *  @brief      Handler called at every 200us.
 */
void MagnetronPilotMainsSampler__200usHandler(uint8 Parent_Pilot_Index)
{
    //! Save Pilot_Index before entering interrupt handler
    uint8 Pilot_Index_Bak = Pilot_Index;

    Pilot_Index = Parent_Pilot_Index;

    uint8 mains_pinState = 0;
    uint8 table_index = Mains_Sampler_Data[Pilot_Index].Mains_Feedback_Pin;
    if (VIRTUALPIN_TABLE[table_index].port != PORT_NULL)
    {
        mains_pinState = Gpio__PinRead(VIRTUALPIN_TABLE[table_index].port, VIRTUALPIN_TABLE[table_index].pin);
    }

    if (Mains_Sampler_Data[Pilot_Index].High_Pulse == TRUE)
    {
        Mains_Sampler_Data[Pilot_Index].High_Counter++;

        if (mains_pinState == 0)
        {
            if (Mains_Sampler_Data[Pilot_Index].High_Counter > Mains_Sampler_Data[Pilot_Index].Min_High_Level_Count) // the condition of accepting the fall edge coming.
            {
                MainsSamplerRecalcEvents(Mains_Sampler_Data[Pilot_Index].Counter);
                Mains_Sampler_Data[Pilot_Index].Low_Counter = 0;
                Mains_Sampler_Data[Pilot_Index].High_Pulse = FALSE;
            }
        }
    }
    else
    {
        Mains_Sampler_Data[Pilot_Index].Low_Counter++;

        if (mains_pinState == 1)
        {
            if (Mains_Sampler_Data[Pilot_Index].Low_Counter > Mains_Sampler_Data[Pilot_Index].Min_Low_Level_Count) // the condition of accepting the rise edge coming.
            {
                if (Mains_Sampler_Data[Pilot_Index].Mains_Period < Mains_Sampler_Data[Pilot_Index].Counter)
                {
                    ++Mains_Sampler_Data[Pilot_Index].Mains_Period;
                }
                else if (Mains_Sampler_Data[Pilot_Index].Mains_Period > Mains_Sampler_Data[Pilot_Index].Counter)
                {
                    --Mains_Sampler_Data[Pilot_Index].Mains_Period;
                }

                if (((Mains_Sampler_Data[Pilot_Index].Mains_Period >= MAINS_LOW_LIMIT_60HZ) && (Mains_Sampler_Data[Pilot_Index].Mains_Period <= MAINS_HIGH_LIMIT_60HZ)) ||
                    ((Mains_Sampler_Data[Pilot_Index].Mains_Period >= MAINS_LOW_LIMIT_50HZ) && (Mains_Sampler_Data[Pilot_Index].Mains_Period <= MAINS_HIGH_LIMIT_50HZ)))
                {
                    Mains_Sampler_Data[Pilot_Index].Mains_Freq_State = MAINS_FREQ_OK;
                    MAINS_PERIOD_SYNC(Pilot_Index, Mains_Sampler_Data[Pilot_Index].Mains_Period);
                }
                else
                {
                    Mains_Sampler_Data[Pilot_Index].Mains_Freq_State = MAINS_FREQ_ERROR;
                }

                Mains_Sampler_Data[Pilot_Index].Counter = 0;
                Mains_Sampler_Data[Pilot_Index].High_Counter = 0;
                Mains_Sampler_Data[Pilot_Index].High_Pulse = TRUE;
            }
        }
    }

    MAINS_EVENT_TYPE mains_event = MAINS_NO_EVENT;

    MainsSamplerMainsLostDetection();

    if (Mains_Sampler_Data[Pilot_Index].Counter == Mains_Sampler_Data[Pilot_Index].Zero_Cross_LH_Cnt1)
    {
        mains_event = ((Mains_Sampler_Data[Pilot_Index].AC_Mains_Same_Phase == TRUE) ? MAINS_ANGLE_0_EVENT : MAINS_ANGLE_180_EVENT);
        MainsSamplerMainsFoundDetection();
    }
    else if (Mains_Sampler_Data[Pilot_Index].Counter == Mains_Sampler_Data[Pilot_Index].L_Pos_Cnt && Mains_Sampler_Data[Pilot_Index].High_Pulse == TRUE)
    {
        mains_event = ((Mains_Sampler_Data[Pilot_Index].AC_Mains_Same_Phase == TRUE) ? MAINS_ANGLE_90_EVENT : MAINS_ANGLE_270_EVENT);
    }
    else if (Mains_Sampler_Data[Pilot_Index].Counter == Mains_Sampler_Data[Pilot_Index].Zero_Cross_HL_Cnt2)
    {
        mains_event = ((Mains_Sampler_Data[Pilot_Index].AC_Mains_Same_Phase == TRUE) ? MAINS_ANGLE_180_EVENT : MAINS_ANGLE_0_EVENT);
        MainsSamplerMainsFoundDetection();
    }
    else if (Mains_Sampler_Data[Pilot_Index].Counter == Mains_Sampler_Data[Pilot_Index].L_Neg_Cnt && Mains_Sampler_Data[Pilot_Index].High_Pulse == FALSE)
    {
        mains_event = ((Mains_Sampler_Data[Pilot_Index].AC_Mains_Same_Phase == TRUE) ? MAINS_ANGLE_270_EVENT : MAINS_ANGLE_90_EVENT);
    }

    MAINS_EVENT_HANDLER(Pilot_Index, mains_event);

    if (Mains_Sampler_Data[Pilot_Index].Counter < Mains_Sampler_Data[Pilot_Index].Max_Count)
    {
        Mains_Sampler_Data[Pilot_Index].Counter++;
    }

    if (Mains_Sampler_Data[Pilot_Index].Low_Counter > Mains_Sampler_Data[Pilot_Index].Max_Count)
    {
        Mains_Sampler_Data[Pilot_Index].Low_Counter = Mains_Sampler_Data[Pilot_Index].Max_Count;
    }

    if (Mains_Sampler_Data[Pilot_Index].High_Counter > Mains_Sampler_Data[Pilot_Index].Max_Count)
    {
        Mains_Sampler_Data[Pilot_Index].High_Counter = Mains_Sampler_Data[Pilot_Index].Max_Count;
    }

    //! Restore Pilot_Index before exiting interrupt handler
    Pilot_Index = Pilot_Index_Bak;
}

//---------------------------------------------------------------------------------------------------------------------
/**
 * @brief      Handler called at every 5ms.
 * @param      load
 * @return
 */
//---------------------------------------------------------------------------------------------------------------------
void MagnetronPilotMainsSampler__AsynchHandler(uint8 Parent_Pilot_Index)
{
    Pilot_Index = Parent_Pilot_Index;

    //! Check if there is mains error msg needed to be published
    if (Mains_Sampler_Data[Pilot_Index].Mains_Detect_State_Changed == TRUE)
    {
        Mains_Sampler_Data[Pilot_Index].Mains_Detect_State_Changed = FALSE;
        if (Mains_Sampler_Data[Pilot_Index].Mains_Detect_State == MAINS_DETECT_STATE_FOUND)
        {
            LOG_ADD_EXCEPTION(MAINS_SIGNAL_FOUND, Pilot_Index);
        }
        else
        {
            LOG_ADD_EXCEPTION(MAINS_SIGNAL_LOST, Pilot_Index);
        }
    }

    if (Mains_Sampler_Data[Pilot_Index].Mains_Detect_Early_Warning == TRUE)
    {
        Mains_Sampler_Data[Pilot_Index].Mains_Detect_Early_Warning = FALSE;
        LOG_ADD_EXCEPTION(MAINS_SIGNAL_EARLY_WARNING, Pilot_Index);
    }
}

//---------------------------------------------------------------------------------------------------------------------
/**
 * @brief      It return the mains detection status
 * @param      Pilot
 * @return
 */
//---------------------------------------------------------------------------------------------------------------------
MAINS_FREQUENCY_TYPE MagnetronPilotMainsSampler__GetMainsFrequencyStatus(uint8 Parent_Pilot_Index)
{
    MAINS_FREQUENCY_TYPE state = MAINS_FREQ_ERROR;

    if (Mains_Sampler_Data[Pilot_Index].Mains_Detect_State == MAINS_DETECT_STATE_FOUND)
    {
        state = Mains_Sampler_Data[Parent_Pilot_Index].Mains_Freq_State;
    }

    return state;
}

//=====================================================================================================================
//-------------------------------------- Private Functions ------------------------------------------------------------
//=====================================================================================================================
//---------------------------------------------------------------------------------------------------------------------
/**
 *  @brief calculate the zero cross point and peak point from mains high rise
 *  when L+ and mains signal is in same phase,
 *      "Zero_Cross_LH_Cnt1" means the zero cross point from N to L,
 *      "Zero_Cross_HL_Cnt2" means the zero cross point from L to N,
 *      "L_Pos_Cnt" means the peak point of L
 *      "L_Neg_Cnt" means the peak point of N
 * when L+ and mains signal is in reverse phase,
 *      "Zero_Cross_LH_Cnt1" means the zero cross point from L to N,
 *      "Zero_Cross_HL_Cnt2" means the zero cross point from N to L,
 *      "L_Pos_Cnt" means the peak point of N
 *      "L_Neg_Cnt" means the peak point of L
 */
static void MainsSamplerRecalcEvents(uint8 count)
{
    uint8 half_mains_period;
    sint8 zero_cross_slot;

    if ((count < Mains_Sampler_Data[Pilot_Index].Max_L_Pos_Count) && (count > Mains_Sampler_Data[Pilot_Index].Min_L_Pos_Count))
    {
        // recalc zero cross
        half_mains_period = Mains_Sampler_Data[Pilot_Index].Mains_Period / 2;

        zero_cross_slot = ((count - half_mains_period)/2);
        Mains_Sampler_Data[Pilot_Index].Zero_Cross_HL_Cnt2 = (half_mains_period + zero_cross_slot);

        if (count > half_mains_period) //mains high width > AC high width
        {
            Mains_Sampler_Data[Pilot_Index].Zero_Cross_LH_Cnt1 = zero_cross_slot;
        }
        else
        {
            Mains_Sampler_Data[Pilot_Index].Zero_Cross_LH_Cnt1 = (Mains_Sampler_Data[Pilot_Index].Zero_Cross_HL_Cnt2 + half_mains_period);
        }

        //recalc positive peak and negative peak
        Mains_Sampler_Data[Pilot_Index].L_Pos_Cnt = (count/2);
        Mains_Sampler_Data[Pilot_Index].L_Neg_Cnt = (Mains_Sampler_Data[Pilot_Index].L_Pos_Cnt + (Mains_Sampler_Data[Pilot_Index].Mains_Period / 2));
    }
}

//---------------------------------------------------------------------------------------------------------------------
/**
 *  @brief      It detect the mains lost state
 *
 */
static void MainsSamplerMainsLostDetection(void)
{
    Mains_Sampler_Data[Pilot_Index].Mains_Period_Wait_Counter++;
    if (Mains_Sampler_Data[Pilot_Index].Mains_Detect_State != MAINS_DETECT_STATE_LOST)
    {
        if (Mains_Sampler_Data[Pilot_Index].Mains_Period_Wait_Counter >= MAINS_LOST_COUNT)
        {
            Mains_Sampler_Data[Pilot_Index].Mains_Detect_State = MAINS_DETECT_STATE_LOST;
            Mains_Sampler_Data[Pilot_Index].Mains_Detect_State_Changed = TRUE;
            Mains_Sampler_Data[Pilot_Index].Mains_Period_Resume_Counter = 0;
        }

        if (Mains_Sampler_Data[Pilot_Index].Mains_Period_Wait_Counter == MAINS_EARLY_WARNING_COUNT)
        {
            Mains_Sampler_Data[Pilot_Index].Mains_Detect_Early_Warning = TRUE;
        }
    }
}

//---------------------------------------------------------------------------------------------------------------------
/**
 *  @brief      It detect the mains found state
 *
 */
static void MainsSamplerMainsFoundDetection(void)
{
    if(Mains_Sampler_Data[Pilot_Index].Mains_Detect_State == MAINS_DETECT_STATE_FOUND)
    {
        Mains_Sampler_Data[Pilot_Index].Mains_Period_Wait_Counter = 0;
    }
    else
    {
        if(Mains_Sampler_Data[Pilot_Index].Mains_Period_Wait_Counter <= MAINS_RESUME_COUNT)
        {
            Mains_Sampler_Data[Pilot_Index].Mains_Period_Wait_Counter = 0;
            Mains_Sampler_Data[Pilot_Index].Mains_Period_Resume_Counter++;
            if(Mains_Sampler_Data[Pilot_Index].Mains_Period_Resume_Counter > 5) //!< 6 zero crosses needed to approve mains
            {
                Mains_Sampler_Data[Pilot_Index].Mains_Detect_State = MAINS_DETECT_STATE_FOUND;
                Mains_Sampler_Data[Pilot_Index].Mains_Detect_State_Changed = TRUE;
            }
        }
        else
        {
            Mains_Sampler_Data[Pilot_Index].Mains_Period_Wait_Counter = 0;
            Mains_Sampler_Data[Pilot_Index].Mains_Period_Resume_Counter = 0;
        }
    }
}

#endif //(HBL_PILOT_NUM_MAGNETRON > 0)

