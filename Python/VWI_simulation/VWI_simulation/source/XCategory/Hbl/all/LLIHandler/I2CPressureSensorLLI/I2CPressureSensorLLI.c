/**
 *  @file       I2CPressureSensorLLI.c
 *
 *  @brief      Basic description of file contents
 *
 *  @details    Detailed description of the file contents
 *
 *  $Header: I2CPressureSensorGI.c 1.0 2017/02/17 09:20:30EDT RAFAEL LIRA BOLZAN (LIRABR2) Exp  $
 *
 *  @copyright  Copyright 2017-$Date: 2017/02/17 09:20:30EDT $. Whirlpool Corporation. All rights reserved - CONFIDENTIAL
 */
//---------------------------------------------------------------------------------------------------------------------
//---------------------------------------------------------------------------------------------------------------------

//-------------------------------------- Include Files ----------------------------------------------------------------
#include "SystemConfig.h"
#include "I2CPressureSensorLLI.h"

#if (HBL_LLI_NUM_I2C_PRESSURE_SENSOR > 0)

#include "I2c.h"
#include "Filter.h"
#include "Fault.h"
#include "Log.h"
#include "SystemTimers.h"
#include <string.h>
#include "VirtualPin.h"
#include "I2CPressureSensorDefs.h"
//-------------------------------------- PRIVATE (Variables, Constants & Defines) -------------------------------------

//! The name of this module for use by the Log module.
#define MODULE_NAME MODULE_I2CPRESSURESENSOR

//! A list of log message IDs that are generated by this module.
typedef enum MODULE_EXTRACTIONSIS_LOG_MESSAGE_ID_ENUM
{
    ERROR_COMMUNICATION  = 1,
    ERROR_DATA_STUCK,
}MODULE_I2CPRESSURESENSOR_LOG_MESSAGE_ID_TYPE;

//! Hold initial value of the filter
#define PRESSURE_SENSOR_INITIAL_FILTER_VALUE     0

//! Hold the default alpha value
#define PRESSURE_SENSOR_DEFAULT_ALPHA    32

//! Hold the number of counts to fault
#define I2C_PRESSURE_FAULT_COUNTER  8

//! Holds the value if pressure sensor is stabilizing
static const sint32 STABILIZING_PRESSURE = I2CPRESSURESENSOR_STABILIZING;

//! Holds the value if there is an active I2C communication failure
static const sint32 FAILURE_PRESSURE = I2CPRESSURESENSOR_I2C_FAILURE;

typedef enum
{
    I2C_PRESSURE_SENSOR_NOT_DEFINED = 0,
    I2C_PRESSURE_SENSOR_REQUEST,
    I2C_PRESSURE_SENSOR_READ
}I2C_PRESSURE_SENSOR_STATE_TYPE;


//! Manufacturer definition - this enum needs to reflect the one defined in the Pressure Sensor GI (PressureSensorGI.c)
typedef enum
{
    I2C_MANUF_NOT_DEFINED = 0,
    I2C_MANUF_ITM = 0x28,
    I2C_MANUF_PANASONIC = 0x27,
} I2C_PRESSURE_MANUFACTURER_TYPE;


PACKED typedef struct
{
    uint16 Unused;
    uint8  Device_Type;
    uint8  Inverted_Alpha;
    uint16 Intital_Time;
} I2C_PRESSURE_SENSOR_PARAM_TYPE;

PACKED typedef struct
{
    I2C_PRESSURE_SENSOR_STATE_TYPE State;
    IIR_FILTER_MEASURE_TYPE Filter;
    uint16 Timer_Index;
    uint16 Pressure;
    uint8 Communication_Error_Counter;
    uint8 Buffer[4];
}I2C_PRESSURE_SENSOR_DATA_TYPE;


static I2C_PRESSURE_SENSOR_DATA_TYPE I2c_Pressure[HBL_LLI_NUM_I2C_PRESSURE_SENSOR];
static uint8 I2CPressure_Sensor_LLI_Allocation;

//-------------------------------------- PRIVATE (Function Prototypes) ------------------------------------------------


//=====================================================================================================================
//-------------------------------------- Public Functions -------------------------------------------------------------
//=====================================================================================================================
//---------------------------------------------------------------------------------------------------------------------
/**
 * @brief   It Initializes the module I2CPressureSensor LLI and its variables
 */
void I2CPressureSensorLLI__Initialize(void)
{
    uint8 index;

    for (index = 0; index < HBL_LLI_NUM_I2C_PRESSURE_SENSOR; index++)
    {
        memset(&I2c_Pressure[index],0,sizeof(I2c_Pressure[0]));
    }

    I2CPressure_Sensor_LLI_Allocation = 0;
}

//---------------------------------------------------------------------------------------------------------------------
/**
 * @brief   Determines the destination (index) of the data for the LLI.
 * @return  Index to a local buffer where the data will reside.
 */
uint8 I2CPressureSensorLLI__Allocate(void)
{
    uint8 retval;
    retval = 0xFF;
    if (I2CPressure_Sensor_LLI_Allocation < HBL_LLI_NUM_I2C_PRESSURE_SENSOR)
    {
        retval = I2CPressure_Sensor_LLI_Allocation;
        I2c_Pressure[I2CPressure_Sensor_LLI_Allocation].Timer_Index = SystemTimers__GetHandle(SYSTEMTIMERS_TYPE_DOWN_COUNTER);
        I2CPressure_Sensor_LLI_Allocation++;
    }
    return (retval);
}

//---------------------------------------------------------------------------------------------------------------------
/**
 * @brief   Initialize an instance of the LLI by extracting parameter data and initializing variables.
 * @param   input: data related to the instance of the LLI
 * @param   PASS if the initialization was successful, else FAIL
 */
PASS_FAIL_TYPE I2CPressureSensorLLI__InitializeInstance(HBL_LLI_TYPE * input)
{
    PASS_FAIL_TYPE retval;
    I2C_PRESSURE_SENSOR_PARAM_TYPE *param_ptr;

    param_ptr = (I2C_PRESSURE_SENSOR_PARAM_TYPE *)(void *)(input->Parameter_Ptr.Data);

    // Read parameter from virtual pin table
    const VIRTUALPIN_TYPE* pin_ptr = &(VIRTUALPIN_TABLE[input->Pin_Ptr[0]]);

    // If device is properly configured
    // Attempt to start timer here, since it migt have a get before loading it in the initialize state
    if( (SystemTimers__SetMs(I2c_Pressure[input->Data_Index].Timer_Index, param_ptr->Intital_Time) == PASS) &&
        (I2c__Initialize((I2C_ENUM_TYPE)pin_ptr->device, (I2C_SPEED_TYPE)pin_ptr->param1, I2C_ADDR_7BITS, (pin_ptr->param0) << 1) == TRUE))
    {
        I2c_Pressure[input->Data_Index].State = I2C_PRESSURE_SENSOR_REQUEST;
        I2c_Pressure[input->Data_Index].Filter.Inverted_Alpha = param_ptr->Inverted_Alpha;

        //Initialize filter
        Filter__Initialize((void *)&(I2c_Pressure[input->Data_Index].Filter), PRESSURE_SENSOR_INITIAL_FILTER_VALUE, FILTER_IIR);

        retval = PASS;
    }
    else
    {
        Fault__ConditionDetected(FAULT_ID_PRESSURE_SENSOR); // Fault detected

        retval = FAIL;
    }

    return (retval);
}

//---------------------------------------------------------------------------------------------------------------------
/**
 * @brief   Retrieves the current value of the LLI
 * @param   input: data related to the instance of the LLI
 * @return  The current value of the LLI
 */
void * I2CPressureSensorLLI__Get(HBL_LLI_TYPE * input)
{
	void* ptr = NULL;

	if (input->Data_Index < I2CPressure_Sensor_LLI_Allocation)
	{
		if (SystemTimers__GetState(I2c_Pressure[input->Data_Index].Timer_Index) == SYSTEMTIMERS_STATE_RUNNING)
		{
			ptr = ((void *)&STABILIZING_PRESSURE);
		}
		else
		{
			if (I2c_Pressure[input->Data_Index].Communication_Error_Counter >= I2C_PRESSURE_FAULT_COUNTER)
			{
				// Return unique pressure value if there is an I2c communication failure
				ptr = (void *)&FAILURE_PRESSURE;
			}
			else // all good
			{
				ptr = ((void *)&I2c_Pressure[input->Data_Index].Filter.Filtered_Value);
			}
		}
	}

    return ptr;
}

//---------------------------------------------------------------------------------------------------------------------
/**
 * @brief   Asynchronous processing of a the LLI
 * @param   input: data related to the instance of the LLI
 * @return  PASS if the LLI was successfully processed, else FAIL
 */
BOOL_TYPE I2CPressureSensorLLI__AsynchProcess(HBL_LLI_TYPE * input)
{
    BOOL_TYPE retval;
    I2C_PRESSURE_SENSOR_DATA_TYPE *ptr;

    retval = FALSE;

    if (input->Data_Index < I2CPressure_Sensor_LLI_Allocation)
    {
        ptr = &I2c_Pressure[input->Data_Index];

        const VIRTUALPIN_TYPE* pin_ptr = &(VIRTUALPIN_TABLE[input->Pin_Ptr[0]]);

        switch(I2c_Pressure[input->Data_Index].State)
        {

            case I2C_PRESSURE_SENSOR_REQUEST:

            	// Request the reading to the device
            	retval = I2c__RequestRead((I2C_ENUM_TYPE)pin_ptr->device, 2);

                ptr->State = I2C_PRESSURE_SENSOR_READ;
                break;


            case I2C_PRESSURE_SENSOR_READ:

                if (I2c__GetStatus((I2C_ENUM_TYPE)pin_ptr->device,I2C_STATUS_STATE) == I2C_STATE_IDLE)// Check if bus is free
                {
                    // Copy the I2c Rx buffer to the I2c_Pressure_Buffer
                	retval = I2c__Read((I2C_ENUM_TYPE)pin_ptr->device, ptr->Buffer, sizeof(ptr->Buffer));	// Copy the I2c Rx buffer to the I2c_Pressure_Buffer

                    // Merge the pressure data bytes
                    ptr->Pressure  = ((uint16)ptr->Buffer[0]) << 8 | ptr->Buffer[1];
                    ptr->Pressure &= 0x3FFF;    // Mask off 2 status bits

                    // Update Filter
                    Filter__Update((void *)&(ptr->Filter), (FILTER_DATA_TYPE)(ptr->Pressure), FILTER_IIR);

                    ptr->Communication_Error_Counter = 0;

                    Fault__ConditionRemoved(FAULT_ID_PRESSURE_SENSOR);

                    ptr->State = I2C_PRESSURE_SENSOR_REQUEST;
                }
                else
                {
                    // Note: There's no action if the Communication_Error_Counter is greater then I2C_PRESSURE_FAULT_COUNTER
                    if (ptr->Communication_Error_Counter == I2C_PRESSURE_FAULT_COUNTER)
                    {
                        ptr->Communication_Error_Counter++; // increment commum. error counter

                        LOG_ADD_EXCEPTION(ERROR_COMMUNICATION, 0); // publish exception

                        Fault__ConditionDetected(FAULT_ID_PRESSURE_SENSOR); // fault detected
                    }
                    else if (ptr->Communication_Error_Counter < I2C_PRESSURE_FAULT_COUNTER)
                    {
                        ptr->Communication_Error_Counter++; // increment commum. error counter
                    }
                    else    //(ptr->Communication_Error_Counter > I2C_PRESSURE_FAULT_COUNTER)
                    {
                        I2c__Clear((I2C_ENUM_TYPE)pin_ptr->device);
                        I2c__ResetBus((I2C_ENUM_TYPE)pin_ptr->device);
                        ptr->State = I2C_PRESSURE_SENSOR_REQUEST;
                    }
                }
                break;

            default:
                // Left blank intentionally
                break;
        }
    }

    return (retval);
}

//=====================================================================================================================
//-------------------------------------- Private Functions ------------------------------------------------------------
//=====================================================================================================================

#endif //(HBL_LLI_NUM_I2C_PRESSURE_SENSOR > 0)
